
/* DO NOT EDIT!  This is an autogenerated file.  See scripts/layoutrom.py. */
OUTPUT_FORMAT("elf32-i386")
OUTPUT_ARCH("i386")
SECTIONS
{
DefaultDPTE = 0xd9ad8 ;
tpm_state = 0xd9b18 ;
reply_msg = 0xd9b14 ;
emulated_drive_gf = 0xd9ae8 ;
Century = 0xd9afc ;
TPM_interface_shutdown = 0xd9b2d ;
BootSequence = 0xd92b4 ;
StackPos = 0xd9abc ;
CDEmu = 0xd92a0 ;
Ps2ctr = 0xd92b3 ;
FloppyDOR = 0xd9b10 ;
TPM_working = 0xd9b2c ;
CDRom_locks = 0xd9aec ;
LastUSBkey = 0xd9b08 ;
Call16Data = 0xd9ac0 ;
RTCusers = 0xd9b04 ;
ExtraStack = 0xd92b8 ;
TimerLast = 0xd9b00 ;
entry_15_official = 0xff859 ;
transition16big = 0xfd2fb ;
entry_13_official = 0xfe3fe ;
irq_trampoline_0x16 = 0xfd3d0 ;
irq_trampoline_0x13 = 0xfd3ca ;
entry_1a_official = 0xffe6e ;
irq_trampoline_0x10 = 0xfd3c7 ;
entry_pnp_prot = 0xfd48e ;
irq_trampoline_0x19 = 0xff83e ;
irq_trampoline_0x18 = 0xfd3d3 ;
entry_iret_official = 0xfff53 ;
entry_09 = 0xfe987 ;
entry_08 = 0xffea5 ;
entry_pnp_real = 0xfd492 ;
entry_19_official = 0xfe6f2 ;
entry_40 = 0xfec59 ;
entry_hwpic1 = 0xffa65 ;
_cfunc16_call16_helper = 0xf8b76 ;
entry_05 = 0xfff54 ;
_cfunc16_check_irqs = 0xf9778 ;
entry_pmm = 0xfd430 ;
_cfunc16_wait_irq = 0xfc377 ;
entry_smp = 0xfd3eb ;
reset_vector = 0xffff0 ;
transition16 = 0xfd2e6 ;
entry_smi = 0xfd3d6 ;
entry_70 = 0xfd723 ;
entry_76 = 0xfe2b8 ;
entry_74 = 0xfd72c ;
entry_75 = 0xfd735 ;
entry_18 = 0xfd751 ;
entry_bios32 = 0xff046 ;
_cfunc16__farcall16 = 0xf8fc7 ;
entry_11 = 0xff84d ;
entry_12 = 0xff841 ;
entry_14 = 0xfe739 ;
entry_16 = 0xfe82e ;
entry_17 = 0xfefd2 ;
entry_10 = 0xff065 ;
transition32_nmi_off = 0xfd2b0 ;
entry_02 = 0xfe2c3 ;
entry_hwpic2 = 0xfe97c ;
entry_0e = 0xfef57 ;

    _reloc_min_align = 0x10 ;
    zonefseg_start = 0xf64a0 ;
    zonefseg_end = 0xf6ca0 ;
    zonelow_base = 0xca000 ;
    final_varlow_start = 0xd92a0 ;
    final_readonly_start = 0xd9b30 ;
    varlow_start = 0xd92a0 ;
    varlow_end = 0xd9b30 ;
    code32init_start = 0xd9b30 ;
    code32init_end = 0xed7c0 ;

    code32flat_start = 0xd92a0 ;
    .text code32flat_start : {


. = ( 0xd92a0 - code32flat_start ) ;
*32flat.*(.data.varlow../src/cdrom.c.25)
. = ( 0xd92b3 - code32flat_start ) ;
*32flat.*(.data.varlow../src/hw/ps2port.c.211)
. = ( 0xd92b4 - code32flat_start ) ;
*32flat.*(.data.varlow../src/boot.c.757)
. = ( 0xd92b8 - code32flat_start ) ;
*32flat.*(.data.varlow../src/stacks.c.319)
. = ( 0xd9abc - code32flat_start ) ;
*32flat.*(.data.varlow../src/stacks.c.320)
. = ( 0xd9ac0 - code32flat_start ) ;
*32flat.*(.data.varlow../src/stacks.c.33)
. = ( 0xd9ad8 - code32flat_start ) ;
*32flat.*(.data.varlow../src/block.c.402)
. = ( 0xd9ae8 - code32flat_start ) ;
*32flat.*(.data.varlow../src/cdrom.c.26)
. = ( 0xd9aec - code32flat_start ) ;
*32flat.*(.data.varlow../src/disk.c.439)
. = ( 0xd9afc - code32flat_start ) ;
*32flat.*(.data.varlow../src/clock.c.30)
. = ( 0xd9b00 - code32flat_start ) ;
*32flat.*(.data.varlow../src/hw/timer.c.131)
. = ( 0xd9b04 - code32flat_start ) ;
*32flat.*(.data.varlow../src/hw/rtc.c.74)
. = ( 0xd9b08 - code32flat_start ) ;
*32flat.*(.data.varlow../src/hw/usb-hid.c.235)
. = ( 0xd9b10 - code32flat_start ) ;
*32flat.*(.data.varlow../src/hw/floppy.c.181)
. = ( 0xd9b14 - code32flat_start ) ;
*32flat.*(.data.varlow../src/hw/mpt-scsi.c.48)
. = ( 0xd9b18 - code32flat_start ) ;
*32flat.*(.data.varlow../src/tcgbios.c.74)
. = ( 0xd9b2c - code32flat_start ) ;
*32flat.*(.data.varlow../src/tcgbios.c.185)
. = ( 0xd9b2d - code32flat_start ) ;
*32flat.*(.data.varlow../src/tcgbios.c.1227)
. = ( 0xd9b30 - code32flat_start ) ;
*32flat.*(.text.hlist_del)
. = ( 0xd9b3f - code32flat_start ) ;
*32flat.*(.text.putc_str)
. = ( 0xd9b4d - code32flat_start ) ;
*32flat.*(.text.memcmp)
. = ( 0xd9b7d - code32flat_start ) ;
*32flat.*(.text.strtcpy)
. = ( 0xd9ba6 - code32flat_start ) ;
*32flat.*(.text.nullTrailingSpace)
. = ( 0xd9bd2 - code32flat_start ) ;
*32flat.*(.text.enable_hwirq)
. = ( 0xd9c12 - code32flat_start ) ;
*32flat.*(.text.usb_add_freelist)
. = ( 0xd9c1f - code32flat_start ) ;
*32flat.*(.text.usb_get_freelist)
. = ( 0xd9c38 - code32flat_start ) ;
*32flat.*(.text.usb_find_desc)
. = ( 0xd9c78 - code32flat_start ) ;
*32flat.*(.text.uhci_hub_reset)
. = ( 0xd9cb9 - code32flat_start ) ;
*32flat.*(.text.uhci_hub_disconnect)
. = ( 0xd9cc8 - code32flat_start ) ;
*32flat.*(.text.ohci_hub_detect)
. = ( 0xd9cd8 - code32flat_start ) ;
*32flat.*(.text.ohci_hub_disconnect)
. = ( 0xd9ce9 - code32flat_start ) ;
*32flat.*(.text.ehci_hub_disconnect)
. = ( 0xd9d00 - code32flat_start ) ;
*32flat.*(.text.ehci_desc2pipe)
. = ( 0xd9de0 - code32flat_start ) ;
*32flat.*(.text.ata_extract_version)
. = ( 0xd9dfc - code32flat_start ) ;
*32flat.*(.text.found_compatibleahci)
. = ( 0xd9dfd - code32flat_start ) ;
*32flat.*(.text.alloc_new)
. = ( 0xd9e50 - code32flat_start ) ;
*32flat.*(.text.alloc_free)
. = ( 0xd9e69 - code32flat_start ) ;
*32flat.*(.text.alloc_find)
. = ( 0xd9e88 - code32flat_start ) ;
*32flat.*(.text.malloc_pfree)
. = ( 0xd9eb8 - code32flat_start ) ;
*32flat.*(.text.malloc_getspace)
. = ( 0xd9ef4 - code32flat_start ) ;
*32flat.*(.text.rom_reserve)
. = ( 0xd9f33 - code32flat_start ) ;
*32flat.*(.text.calcRamSize)
. = ( 0xd9f83 - code32flat_start ) ;
*32flat.*(.text.__romfile_findprefix)
. = ( 0xd9fb4 - code32flat_start ) ;
*32flat.*(.text.romfile_findprefix)
. = ( 0xd9fcc - code32flat_start ) ;
*32flat.*(.text.romfile_find)
. = ( 0xd9fe1 - code32flat_start ) ;
*32flat.*(.text.romfile_loadint)
. = ( 0xda03e - code32flat_start ) ;
*32flat.*(.text.is_pci_vga)
. = ( 0xda089 - code32flat_start ) ;
*32flat.*(.text.add_bev)
. = ( 0xda0dc - code32flat_start ) ;
*32flat.*(.text.fillbits)
. = ( 0xda157 - code32flat_start ) ;
*32flat.*(.text.dec_rec2)
. = ( 0xda253 - code32flat_start ) ;
*32flat.*(.text.idct)
. = ( 0xda56d - code32flat_start ) ;
*32flat.*(.text.idctqtab)
. = ( 0xda5c8 - code32flat_start ) ;
*32flat.*(.text.scaleidctqtab)
. = ( 0xda5df - code32flat_start ) ;
*32flat.*(.text.tpm_can_show_menu)
. = ( 0xda613 - code32flat_start ) ;
*32flat.*(.text.pci_find_device)
. = ( 0xda63c - code32flat_start ) ;
*32flat.*(.text.pci_find_class)
. = ( 0xda659 - code32flat_start ) ;
*32flat.*(.text.pci_init_device)
. = ( 0xda6b2 - code32flat_start ) ;
*32flat.*(.text.xhci_hub_detect)
. = ( 0xda6c1 - code32flat_start ) ;
*32flat.*(.text.xhci_hub_disconnect)
. = ( 0xda6c2 - code32flat_start ) ;
*32flat.*(.text.get_acpi_rsdp_length)
. = ( 0xda71e - code32flat_start ) ;
*32flat.*(.text.smbios_next)
. = ( 0xda77b - code32flat_start ) ;
*32flat.*(.text.pci_set_io_region_addr)
. = ( 0xda7d1 - code32flat_start ) ;
*32flat.*(.text.piix_pci_slot_get_irq)
. = ( 0xda805 - code32flat_start ) ;
*32flat.*(.text.mch_pci_slot_get_irq)
. = ( 0xda842 - code32flat_start ) ;
*32flat.*(.text.storage_ide_setup)
. = ( 0xda89c - code32flat_start ) ;
*32flat.*(.text.piix_ide_setup)
. = ( 0xda8c3 - code32flat_start ) ;
*32flat.*(.text.pic_ibm_setup)
. = ( 0xda8d7 - code32flat_start ) ;
*32flat.*(.text.apple_macio_setup)
. = ( 0xda8eb - code32flat_start ) ;
*32flat.*(.text.ich9_smbus_setup)
. = ( 0xda8f8 - code32flat_start ) ;
*32flat.*(.text.i440fx_mem_addr_setup)
. = ( 0xda936 - code32flat_start ) ;
*32flat.*(.text.apic_id_is_present)
. = ( 0xda94d - code32flat_start ) ;
*32flat.*(.text.piix4_fadt_setup)
. = ( 0xda9ab - code32flat_start ) ;
*32flat.*(.text.ich9_lpc_fadt_setup)
. = ( 0xdaa08 - code32flat_start ) ;
*32flat.*(.text.getHex)
. = ( 0xdaa18 - code32flat_start ) ;
*32flat.*(.text.encodeLen)
. = ( 0xdaa56 - code32flat_start ) ;
*32flat.*(.text.smbios_init_type_19)
. = ( 0xdaa90 - code32flat_start ) ;
*32flat.*(.text.smbios_init_type_20)
. = ( 0xdaae6 - code32flat_start ) ;
*32flat.*(.text.romfile_loader_find)
. = ( 0xdab1c - code32flat_start ) ;
*32flat.*(.text.vp_get_features)
. = ( 0xdab94 - code32flat_start ) ;
*32flat.*(.text.vp_set_features)
. = ( 0xdac18 - code32flat_start ) ;
*32flat.*(.text.vp_get_status)
. = ( 0xdac41 - code32flat_start ) ;
*32flat.*(.text.vp_set_status)
. = ( 0xdac80 - code32flat_start ) ;
*32flat.*(.text.vp_reset)
. = ( 0xdacd6 - code32flat_start ) ;
*32flat.*(.text.build_notify)
. = ( 0xdad7a - code32flat_start ) ;
*32flat.*(.text.memmove)
. = ( 0xdada8 - code32flat_start ) ;
*32flat.*(.text.remove_e820)
. = ( 0xdadd3 - code32flat_start ) ;
*32flat.*(.text.tpm20_write_EfiSpecIdEventStruct)
. = ( 0xdaec1 - code32flat_start ) ;
*32flat.*(.text.snprintf)
. = ( 0xdaf0d - code32flat_start ) ;
*32flat.*(.text.get_field)
. = ( 0xdaf58 - code32flat_start ) ;
*32flat.*(.text.smbios_init_type_4)
. = ( 0xdb196 - code32flat_start ) ;
*32flat.*(.text.smbios_init_type_17)
. = ( 0xdb2ef - code32flat_start ) ;
*32flat.*(.text.pci_bios_init_bus_rec)
. = ( 0xdb4e8 - code32flat_start ) ;
*32flat.*(.text.dummy_pci_slot_get_irq)
. = ( 0xdb4f9 - code32flat_start ) ;
*32flat.*(.text.piix_isa_bridge_setup)
. = ( 0xdb570 - code32flat_start ) ;
*32flat.*(.text.find_prio)
. = ( 0xdb5f5 - code32flat_start ) ;
*32flat.*(.text.bootprio_find_named_rom)
. = ( 0xdb646 - code32flat_start ) ;
*32flat.*(.text.pmtimer_setup)
. = ( 0xdb669 - code32flat_start ) ;
*32flat.*(.text.piix4_pm_setup)
. = ( 0xdb693 - code32flat_start ) ;
*32flat.*(.text.i8042_flush)
. = ( 0xdb6cb - code32flat_start ) ;
*32flat.*(.text.i8042_command)
. = ( 0xdb768 - code32flat_start ) ;
*32flat.*(.text.get_external)
. = ( 0xdb8ed - code32flat_start ) ;
*32flat.*(.text.wrmsr_smp)
. = ( 0xdb939 - code32flat_start ) ;
*32flat.*(.text.deploy_romfile)
. = ( 0xdb988 - code32flat_start ) ;
*32flat.*(.text.alloc_new_detail)
. = ( 0xdba17 - code32flat_start ) ;
*32flat.*(.text.alloc_add)
. = ( 0xdba76 - code32flat_start ) ;
*32flat.*(.text.malloc_palloc)
. = ( 0xdbab8 - code32flat_start ) ;
*32flat.*(.text.malloc_high)
. = ( 0xdbac9 - code32flat_start ) ;
*32flat.*(.text.malloc_fseg)
. = ( 0xdbada - code32flat_start ) ;
*32flat.*(.text.memalign_high)
. = ( 0xdbae6 - code32flat_start ) ;
*32flat.*(.text.malloc_tmphigh)
. = ( 0xdbaf7 - code32flat_start ) ;
*32flat.*(.text.malloc_tmplow)
. = ( 0xdbb08 - code32flat_start ) ;
*32flat.*(.text.malloc_tmp)
. = ( 0xdbb1e - code32flat_start ) ;
*32flat.*(.text.memalign_tmphigh)
. = ( 0xdbb2a - code32flat_start ) ;
*32flat.*(.text.run_thread)
. = ( 0xdbbb7 - code32flat_start ) ;
*32flat.*(.text.memalign_tmp)
. = ( 0xdbbd9 - code32flat_start ) ;
*32flat.*(.text.malloc_low)
. = ( 0xdbbea - code32flat_start ) ;
*32flat.*(.text.copy_smbios)
. = ( 0xdbc80 - code32flat_start ) ;
*32flat.*(.text.copy_acpi_rsdp)
. = ( 0xdbcdb - code32flat_start ) ;
*32flat.*(.text.copy_mptable)
. = ( 0xdbda7 - code32flat_start ) ;
*32flat.*(.text.copy_pir)
. = ( 0xdbe16 - code32flat_start ) ;
*32flat.*(.text.pvscsi_init_rings)
. = ( 0xdbf45 - code32flat_start ) ;
*32flat.*(.text.pci_region_create_entry)
. = ( 0xdc049 - code32flat_start ) ;
*32flat.*(.text.qemu_romfile_add)
. = ( 0xdc0cb - code32flat_start ) ;
*32flat.*(.text.pci_probe_devices)
. = ( 0xdc288 - code32flat_start ) ;
*32flat.*(.text.bootentry_add)
. = ( 0xdc333 - code32flat_start ) ;
*32flat.*(.text.boot_add_cd)
. = ( 0xdc354 - code32flat_start ) ;
*32flat.*(.text.boot_add_hd)
. = ( 0xdc375 - code32flat_start ) ;
*32flat.*(.text.boot_add_bcv)
. = ( 0xdc3b6 - code32flat_start ) ;
*32flat.*(.text.xhci_alloc_inctx)
. = ( 0xdc49c - code32flat_start ) ;
*32flat.*(.text.insert_e820)
. = ( 0xdc539 - code32flat_start ) ;
*32flat.*(.text.e820_add)
. = ( 0xdc775 - code32flat_start ) ;
*32flat.*(.text.mch_mem_addr_setup)
. = ( 0xdc7e3 - code32flat_start ) ;
*32flat.*(.text.mch_isa_bridge_setup)
. = ( 0xdc8a2 - code32flat_start ) ;
*32flat.*(.text.init_atadrive)
. = ( 0xdc90e - code32flat_start ) ;
*32flat.*(.text.init_floppy)
. = ( 0xdc9a3 - code32flat_start ) ;
*32flat.*(.text.create_bounce_buf)
. = ( 0xdc9df - code32flat_start ) ;
*32flat.*(.text.free)
. = ( 0xdca04 - code32flat_start ) ;
*32flat.*(.text.pci_region_map_entries)
. = ( 0xdcc04 - code32flat_start ) ;
*32flat.*(.text.vp_find_vq)
. = ( 0xdcec5 - code32flat_start ) ;
*32flat.*(.text.intel_igd_setup)
. = ( 0xdcff7 - code32flat_start ) ;
*32flat.*(.text.romfile_loadfile)
. = ( 0xdd072 - code32flat_start ) ;
*32flat.*(.text.__end_thread)
. = ( 0xdd09d - code32flat_start ) ;
*32flat.*(.text.znprintf)
. = ( 0xdd10d - code32flat_start ) ;
*32flat.*(.text.qemu_cfg_read_file)
. = ( 0xdd163 - code32flat_start ) ;
*32flat.*(.text.sdcard_set_frequency)
. = ( 0xdd1f7 - code32flat_start ) ;
*32flat.*(.text.xhci_hub_reset)
. = ( 0xdd2c6 - code32flat_start ) ;
*32flat.*(.text.wait_bit)
. = ( 0xdd318 - code32flat_start ) ;
*32flat.*(.text.powerup_await_non_bsy)
. = ( 0xdd36b - code32flat_start ) ;
*32flat.*(.text.ehci_wait_controllers)
. = ( 0xdd37c - code32flat_start ) ;
*32flat.*(.text.ohci_hub_reset)
. = ( 0xdd40b - code32flat_start ) ;
*32flat.*(.text.usb_enumerate)
. = ( 0xdd483 - code32flat_start ) ;
*32flat.*(.text.configure_uhci)
. = ( 0xdd629 - code32flat_start ) ;
*32flat.*(.text.msleep)
. = ( 0xdd635 - code32flat_start ) ;
*32flat.*(.text.configure_xhci)
. = ( 0xdd938 - code32flat_start ) ;
*32flat.*(.text.ehci_hub_reset)
. = ( 0xdd979 - code32flat_start ) ;
*32flat.*(.text.ehci_hub_detect)
. = ( 0xdd9c4 - code32flat_start ) ;
*32flat.*(.text.uhci_hub_detect)
. = ( 0xdd9f0 - code32flat_start ) ;
*32flat.*(.text.iomemcpy)
. = ( 0xdda36 - code32flat_start ) ;
*32flat.*(.text.wait_preempt)
. = ( 0xdda60 - code32flat_start ) ;
*32flat.*(.text.xhci_cmd_submit)
. = ( 0xddb2d - code32flat_start ) ;
*32flat.*(.text.wait_threads)
. = ( 0xddb41 - code32flat_start ) ;
*32flat.*(.text.get_keystroke)
. = ( 0xddbcc - code32flat_start ) ;
*32flat.*(.text.getFBSize.clone.12)
. = ( 0xddbf0 - code32flat_start ) ;
*32flat.*(.text.usb_get_period.clone.18)
. = ( 0xddc0c - code32flat_start ) ;
*32flat.*(.text.usb_realloc_pipe)
. = ( 0xdeb08 - code32flat_start ) ;
*32flat.*(.text.usb_free_pipe)
. = ( 0xdeb14 - code32flat_start ) ;
*32flat.*(.text.usb_alloc_pipe)
. = ( 0xdeb1d - code32flat_start ) ;
*32flat.*(.text.getword.clone.26)
. = ( 0xdeb3a - code32flat_start ) ;
*32flat.*(.text.readtables)
. = ( 0xdeebc - code32flat_start ) ;
*32flat.*(.text.pci_find_capability.clone.30)
. = ( 0xdef3f - code32flat_start ) ;
*32flat.*(.text.pci_region_align.clone.41)
. = ( 0xdef5b - code32flat_start ) ;
*32flat.*(.text.pci_region_sum.clone.42)
. = ( 0xdef82 - code32flat_start ) ;
*32flat.*(.text.pci_bios_init_root_regions_mem)
. = ( 0xdf07c - code32flat_start ) ;
*32flat.*(.text.pci_region_migrate_64bit_entries.clone.43)
. = ( 0xdf0c8 - code32flat_start ) ;
*32flat.*(.text.build_usb_path.clone.50)
. = ( 0xdf10b - code32flat_start ) ;
*32flat.*(.text.ahci_port_reset.clone.56)
. = ( 0xdf190 - code32flat_start ) ;
*32flat.*(.text.ahci_port_release)
. = ( 0xdf1c1 - code32flat_start ) ;
*32flat.*(.text.configure_ehci)
. = ( 0xdf3f9 - code32flat_start ) ;
*32flat.*(.text.usb_send_default_control)
. = ( 0xdf418 - code32flat_start ) ;
*32flat.*(.text.usb_hub_disconnect)
. = ( 0xdf481 - code32flat_start ) ;
*32flat.*(.text.get_port_status)
. = ( 0xdf4da - code32flat_start ) ;
*32flat.*(.text.usb_hub_detect)
. = ( 0xdf509 - code32flat_start ) ;
*32flat.*(.text.set_port_feature)
. = ( 0xdf559 - code32flat_start ) ;
*32flat.*(.text.usb_hub_reset)
. = ( 0xdf612 - code32flat_start ) ;
*32flat.*(.text.configure_ohci)
. = ( 0xdf893 - code32flat_start ) ;
*32flat.*(.text.detect_serial.clone.64)
. = ( 0xdf8db - code32flat_start ) ;
*32flat.*(.text.detect_parport.clone.65)
. = ( 0xdf916 - code32flat_start ) ;
*32flat.*(.text.pci_config_maskw.clone.66)
. = ( 0xdf935 - code32flat_start ) ;
*32flat.*(.text.pci_enable_busmaster)
. = ( 0xdf958 - code32flat_start ) ;
*32flat.*(.text.pci_enable_iobar)
. = ( 0xdf9c8 - code32flat_start ) ;
*32flat.*(.text.pci_enable_membar)
. = ( 0xdfa55 - code32flat_start ) ;
*32flat.*(.text.vp_init_simple)
. = ( 0xdfd13 - code32flat_start ) ;
*32flat.*(.text.call16_int10)
. = ( 0xdfd3c - code32flat_start ) ;
*32flat.*(.text.enable_vga_console)
. = ( 0xdfeaf - code32flat_start ) ;
*32flat.*(.text.ps2_recvbyte.clone.69)
. = ( 0xdff3a - code32flat_start ) ;
*32flat.*(.text.ps2_sendbyte.clone.70)
. = ( 0xdff7a - code32flat_start ) ;
*32flat.*(.text.__ps2_command.clone.71)
. = ( 0xe0110 - code32flat_start ) ;
*32flat.*(.text.ps2_keyboard_setup)
. = ( 0xe0260 - code32flat_start ) ;
*32flat.*(.text.set_protocol.clone.72)
. = ( 0xe028e - code32flat_start ) ;
*32flat.*(.text.send_ata_identity)
. = ( 0xe032d - code32flat_start ) ;
*32flat.*(.text.ata_extract_model.clone.75)
. = ( 0xe0352 - code32flat_start ) ;
*32flat.*(.text.init_controller.clone.76)
. = ( 0xe03fe - code32flat_start ) ;
*32flat.*(.text.found_genericata)
. = ( 0xe04be - code32flat_start ) ;
*32flat.*(.text.build_pci_path.clone.77)
. = ( 0xe0573 - code32flat_start ) ;
*32flat.*(.text.addFloppy)
. = ( 0xe060b - code32flat_start ) ;
*32flat.*(.text.device_hardware_setup)
. = ( 0xe111a - code32flat_start ) ;
*32flat.*(.text.bootprio_find_pci_device)
. = ( 0xe113e - code32flat_start ) ;
*32flat.*(.text.init_virtio_blk)
. = ( 0xe1384 - code32flat_start ) ;
*32flat.*(.text.bootprio_find_scsi_device)
. = ( 0xe13d7 - code32flat_start ) ;
*32flat.*(.text.bootprio_find_ata_device)
. = ( 0xe142a - code32flat_start ) ;
*32flat.*(.text.ahci_port_setup)
. = ( 0xe1878 - code32flat_start ) ;
*32flat.*(.text.ahci_port_detect)
. = ( 0xe1a09 - code32flat_start ) ;
*32flat.*(.text.ata_detect)
. = ( 0xe1dff - code32flat_start ) ;
*32flat.*(.text.getRomPriority)
. = ( 0xe1e6c - code32flat_start ) ;
*32flat.*(.text.bootprio_find_usb)
. = ( 0xe1efd - code32flat_start ) ;
*32flat.*(.text.tpm12_get_capability)
. = ( 0xe1fb3 - code32flat_start ) ;
*32flat.*(.text.tpm12_read_has_owner)
. = ( 0xe1fe6 - code32flat_start ) ;
*32flat.*(.text.init_optionrom)
. = ( 0xe2115 - code32flat_start ) ;
*32flat.*(.text.init_pcirom)
. = ( 0xe22f0 - code32flat_start ) ;
*32flat.*(.text.run_file_roms)
. = ( 0xe233c - code32flat_start ) ;
*32flat.*(.text.optionrom_setup)
. = ( 0xe254a - code32flat_start ) ;
*32flat.*(.text.tpm12_read_permanent_flags.clone.80)
. = ( 0xe2590 - code32flat_start ) ;
*32flat.*(.text.tpm12_enable_tpm.clone.55)
. = ( 0xe25d1 - code32flat_start ) ;
*32flat.*(.text.tpm12_activate_tpm.clone.81)
. = ( 0xe2652 - code32flat_start ) ;
*32flat.*(.text.tpm12_set_owner_install.clone.83)
. = ( 0xe26e8 - code32flat_start ) ;
*32flat.*(.text.interactive_bootmenu)
. = ( 0xe45fa - code32flat_start ) ;
*32flat.*(.text.sdcard_pio_app.clone.85)
. = ( 0xe4636 - code32flat_start ) ;
*32flat.*(.text.sdcard_card_setup)
. = ( 0xe4a95 - code32flat_start ) ;
*32flat.*(.text.sdcard_controller_setup)
. = ( 0xe4bb1 - code32flat_start ) ;
*32flat.*(.text.sdcard_romfile_setup)
. = ( 0xe4bee - code32flat_start ) ;
*32flat.*(.text.sdcard_pci_setup)
. = ( 0xe4c17 - code32flat_start ) ;
*32flat.*(.text.build_header.clone.87)
. = ( 0xe4c5b - code32flat_start ) ;
*32flat.*(.text.acpi_setup)
. = ( 0xe589c - code32flat_start ) ;
*32flat.*(.text.qemu_platform_setup)
. = ( 0xe803d - code32flat_start ) ;
*32flat.*(.text.init../src/stacks.c.724)
. = ( 0xe804d - code32flat_start ) ;
*32flat.*(.text.scsi_drive_setup)
. = ( 0xe8389 - code32flat_start ) ;
*32flat.*(.text.init_virtio_scsi)
. = ( 0xe8523 - code32flat_start ) ;
*32flat.*(.text.init_pvscsi)
. = ( 0xe8628 - code32flat_start ) ;
*32flat.*(.text.init_mpt_scsi)
. = ( 0xe876e - code32flat_start ) ;
*32flat.*(.text.megasas_scan_target)
. = ( 0xe8942 - code32flat_start ) ;
*32flat.*(.text.init_megasas)
. = ( 0xe8b70 - code32flat_start ) ;
*32flat.*(.text.init_esp_scsi)
. = ( 0xe8c5b - code32flat_start ) ;
*32flat.*(.text.init_lsi_scsi)
. = ( 0xe8d46 - code32flat_start ) ;
*32flat.*(.text.usb_hub_port_setup)
. = ( 0xe9671 - code32flat_start ) ;
*32flat.*(.text.maininit)
. = ( 0xeb333 - code32flat_start ) ;
*32flat.*(.text.init../src/post.c.301)
. = ( 0xeb637 - code32flat_start ) ;
*32flat.*(.text.init../src/pmm.c.120)
. = ( 0xeb7c4 - code32flat_start ) ;
*32flat.*(.rodata.vp_init_simple)
. = ( 0xeb7d8 - code32flat_start ) ;
*32flat.*(.rodata.interactive_bootmenu)
. = ( 0xeb7fc - code32flat_start ) ;
*32flat.*(.rodata.pci_irqs)
. = ( 0xeb800 - code32flat_start ) ;
*32flat.*(.rodata.__func__.15090)
. = ( 0xeb814 - code32flat_start ) ;
*32flat.*(.rodata.__func__.15073)
. = ( 0xeb828 - code32flat_start ) ;
*32flat.*(.rodata.__func__.15015)
. = ( 0xeb838 - code32flat_start ) ;
*32flat.*(.rodata.__func__.14953)
. = ( 0xeb844 - code32flat_start ) ;
*32flat.*(.rodata.__func__.14622)
. = ( 0xeb85c - code32flat_start ) ;
*32flat.*(.rodata.__func__.14578)
. = ( 0xeb874 - code32flat_start ) ;
*32flat.*(.rodata.__func__.14589)
. = ( 0xeb890 - code32flat_start ) ;
*32flat.*(.rodata.__func__.14600)
. = ( 0xeb8ac - code32flat_start ) ;
*32flat.*(.rodata.__func__.14612)
. = ( 0xeb8cc - code32flat_start ) ;
*32flat.*(.rodata.__func__.14504)
. = ( 0xeb8e0 - code32flat_start ) ;
*32flat.*(.rodata.__func__.14423)
. = ( 0xeb8f0 - code32flat_start ) ;
*32flat.*(.rodata.__func__.14402)
. = ( 0xeb90c - code32flat_start ) ;
*32flat.*(.rodata.__func__.14344)
. = ( 0xeb91c - code32flat_start ) ;
*32flat.*(.rodata.acpi_find_tbl)
. = ( 0xeb958 - code32flat_start ) ;
*32flat.*(.rodata.AmlCode)
. = ( 0xeca90 - code32flat_start ) ;
*32flat.*(.rodata.__func__.14332)
. = ( 0xeca9c - code32flat_start ) ;
*32flat.*(.rodata.fadt_init_tbl)
. = ( 0xecad8 - code32flat_start ) ;
*32flat.*(.rodata.__func__.14172)
. = ( 0xecae4 - code32flat_start ) ;
*32flat.*(.rodata.ssdp_misc_aml)
. = ( 0xecc48 - code32flat_start ) ;
*32flat.*(.rodata.__func__.14252)
. = ( 0xecc54 - code32flat_start ) ;
*32flat.*(.rodata.__func__.14245)
. = ( 0xecc60 - code32flat_start ) ;
*32flat.*(.rodata.__func__.14178)
. = ( 0xecc6c - code32flat_start ) ;
*32flat.*(.rodata.__func__.14277)
. = ( 0xecc78 - code32flat_start ) ;
*32flat.*(.rodata.__func__.14297)
. = ( 0xecc84 - code32flat_start ) ;
*32flat.*(.rodata.__func__.14320)
. = ( 0xecc94 - code32flat_start ) ;
*32flat.*(.rodata.__func__.13992)
. = ( 0xecca0 - code32flat_start ) ;
*32flat.*(.rodata.__func__.13885)
. = ( 0xeccac - code32flat_start ) ;
*32flat.*(.rodata.__func__.13653)
. = ( 0xeccc4 - code32flat_start ) ;
*32flat.*(.rodata.pci_platform_tbl)
. = ( 0xecd00 - code32flat_start ) ;
*32flat.*(.rodata.region_type_name)
. = ( 0xecd0c - code32flat_start ) ;
*32flat.*(.rodata.__func__.13759)
. = ( 0xecd24 - code32flat_start ) ;
*32flat.*(.rodata.pci_device_tbl)
. = ( 0xece3c - code32flat_start ) ;
*32flat.*(.rodata.__func__.13575)
. = ( 0xece4c - code32flat_start ) ;
*32flat.*(.rodata.__func__.13292)
. = ( 0xece60 - code32flat_start ) ;
*32flat.*(.rodata.__func__.13297)
. = ( 0xece78 - code32flat_start ) ;
*32flat.*(.rodata.__func__.13284)
. = ( 0xece8c - code32flat_start ) ;
*32flat.*(.rodata.__func__.13219)
. = ( 0xecea0 - code32flat_start ) ;
*32flat.*(.rodata.__func__.13170)
. = ( 0xeceb8 - code32flat_start ) ;
*32flat.*(.rodata.__func__.13136)
. = ( 0xecec4 - code32flat_start ) ;
*32flat.*(.rodata.__func__.13064)
. = ( 0xeced4 - code32flat_start ) ;
*32flat.*(.rodata.__func__.13051)
. = ( 0xecee4 - code32flat_start ) ;
*32flat.*(.rodata.__func__.13043)
. = ( 0xecef0 - code32flat_start ) ;
*32flat.*(.rodata.__func__.12183)
. = ( 0xecf08 - code32flat_start ) ;
*32flat.*(.rodata.__func__.12165)
. = ( 0xecf1c - code32flat_start ) ;
*32flat.*(.rodata.__func__.12001)
. = ( 0xecf2c - code32flat_start ) ;
*32flat.*(.rodata.__func__.11895)
. = ( 0xecf40 - code32flat_start ) ;
*32flat.*(.rodata.__func__.11869)
. = ( 0xecf50 - code32flat_start ) ;
*32flat.*(.rodata.__func__.11858)
. = ( 0xecf60 - code32flat_start ) ;
*32flat.*(.rodata.speed_to_xhci)
. = ( 0xecf70 - code32flat_start ) ;
*32flat.*(.rodata.__func__.11834)
. = ( 0xecf84 - code32flat_start ) ;
*32flat.*(.rodata.__func__.11703)
. = ( 0xecf9c - code32flat_start ) ;
*32flat.*(.rodata.__func__.11688)
. = ( 0xecfac - code32flat_start ) ;
*32flat.*(.rodata.speed_from_xhci)
. = ( 0xecfec - code32flat_start ) ;
*32flat.*(.rodata.__func__.11665)
. = ( 0xecffc - code32flat_start ) ;
*32flat.*(.rodata.__func__.11634)
. = ( 0xed008 - code32flat_start ) ;
*32flat.*(.rodata.__func__.11447)
. = ( 0xed01c - code32flat_start ) ;
*32flat.*(.rodata.__func__.11475)
. = ( 0xed02c - code32flat_start ) ;
*32flat.*(.rodata.__func__.11325)
. = ( 0xed044 - code32flat_start ) ;
*32flat.*(.rodata.__func__.11267)
. = ( 0xed054 - code32flat_start ) ;
*32flat.*(.rodata.__func__.11260)
. = ( 0xed064 - code32flat_start ) ;
*32flat.*(.rodata.__func__.11293)
. = ( 0xed074 - code32flat_start ) ;
*32flat.*(.rodata.__func__.11276)
. = ( 0xed088 - code32flat_start ) ;
*32flat.*(.rodata.__func__.11143)
. = ( 0xed09c - code32flat_start ) ;
*32flat.*(.rodata.__func__.11137)
. = ( 0xed0b0 - code32flat_start ) ;
*32flat.*(.rodata.__func__.11057)
. = ( 0xed0c2 - code32flat_start ) ;
*32flat.*(.rodata.CommandFlag_FALSE)
. = ( 0xed0c3 - code32flat_start ) ;
*32flat.*(.rodata.CommandFlag_TRUE)
. = ( 0xed0c4 - code32flat_start ) ;
*32flat.*(.rodata.PhysicalPresence_NOT_PRESENT_LOCK)
. = ( 0xed0c8 - code32flat_start ) ;
*32flat.*(.rodata.evt_separator.10668)
. = ( 0xed0cc - code32flat_start ) ;
*32flat.*(.rodata.Startup_ST_CLEAR)
. = ( 0xed0ce - code32flat_start ) ;
*32flat.*(.rodata.PhysicalPresence_PRESENT)
. = ( 0xed0d0 - code32flat_start ) ;
*32flat.*(.rodata.PhysicalPresence_CMD_ENABLE)
. = ( 0xed0d2 - code32flat_start ) ;
*32flat.*(.rodata.Startup_SU_CLEAR)
. = ( 0xed0d4 - code32flat_start ) ;
*32flat.*(.rodata.C.679.24322)
. = ( 0xed0e4 - code32flat_start ) ;
*32flat.*(.rodata.C.678.24321)
. = ( 0xed0f0 - code32flat_start ) ;
*32flat.*(.rodata.__func__.10605)
. = ( 0xed104 - code32flat_start ) ;
*32flat.*(.rodata.zig)
. = ( 0xed144 - code32flat_start ) ;
*32flat.*(.rodata.aaidct)
. = ( 0xed164 - code32flat_start ) ;
*32flat.*(.rodata.__func__.9318)
. = ( 0xed178 - code32flat_start ) ;
*32flat.*(.rodata.__func__.9009)
. = ( 0xed188 - code32flat_start ) ;
*32flat.*(.rodata.__func__.8896)
. = ( 0xed198 - code32flat_start ) ;
*32flat.*(.rodata.__func__.8729)
. = ( 0xed1a8 - code32flat_start ) ;
*32flat.*(.rodata.__func__.8753)
. = ( 0xed1b4 - code32flat_start ) ;
*32flat.*(.rodata.__func__.8711)
. = ( 0xed1c4 - code32flat_start ) ;
*32flat.*(.rodata.__func__.8649)
. = ( 0xed1d8 - code32flat_start ) ;
*32flat.*(.rodata.__func__.8354)
. = ( 0xed1ec - code32flat_start ) ;
*32flat.*(.rodata.__func__.8528)
. = ( 0xed1f8 - code32flat_start ) ;
*32flat.*(.rodata.__func__.8457)
. = ( 0xed200 - code32flat_start ) ;
*32flat.*(.rodata.__func__.8232)
. = ( 0xed20c - code32flat_start ) ;
*32flat.*(.rodata.__func__.7943)
. = ( 0xed220 - code32flat_start ) ;
*32flat.*(.rodata.__func__.7804)
. = ( 0xed234 - code32flat_start ) ;
*32flat.*(.rodata.__func__.7797)
. = ( 0xed244 - code32flat_start ) ;
*32flat.*(.rodata.__func__.7664)
. = ( 0xed258 - code32flat_start ) ;
*32flat.*(.rodata.__func__.7590)
. = ( 0xed26c - code32flat_start ) ;
*32flat.*(.rodata.__func__.7531)
. = ( 0xed27c - code32flat_start ) ;
*32flat.*(.rodata.pci_ata_tbl)
. = ( 0xed2b8 - code32flat_start ) ;
*32flat.*(.rodata.__func__.7481)
. = ( 0xed2c8 - code32flat_start ) ;
*32flat.*(.rodata.__func__.7447)
. = ( 0xed2e0 - code32flat_start ) ;
*32flat.*(.rodata.__func__.7228)
. = ( 0xed2ec - code32flat_start ) ;
*32flat.*(.rodata.__func__.7417)
. = ( 0xed2fc - code32flat_start ) ;
*32flat.*(.rodata.__func__.7017)
. = ( 0xed308 - code32flat_start ) ;
*32flat.*(.rodata.__func__.6859)
. = ( 0xed318 - code32flat_start ) ;
*32flat.*(.rodata.__func__.6768)
. = ( 0xed32c - code32flat_start ) ;
*32flat.*(.rodata.__func__.6507)
. = ( 0xed340 - code32flat_start ) ;
*32flat.*(.rodata.__func__.6480)
. = ( 0xed358 - code32flat_start ) ;
*32flat.*(.rodata.__func__.6436)
. = ( 0xed370 - code32flat_start ) ;
*32flat.*(.rodata.__func__.6419)
. = ( 0xed380 - code32flat_start ) ;
*32flat.*(.rodata.__func__.6280)
. = ( 0xed394 - code32flat_start ) ;
*32flat.*(.rodata.__func__.6218)
. = ( 0xed3ac - code32flat_start ) ;
*32flat.*(.rodata.__func__.6204)
. = ( 0xed3bc - code32flat_start ) ;
*32flat.*(.rodata.__func__.6191)
. = ( 0xed3c8 - code32flat_start ) ;
*32flat.*(.rodata.__func__.6154)
. = ( 0xed3d8 - code32flat_start ) ;
*32flat.*(.rodata.__func__.6055)
. = ( 0xed3ec - code32flat_start ) ;
*32flat.*(.rodata.__func__.6029)
. = ( 0xed404 - code32flat_start ) ;
*32flat.*(.rodata.__func__.6001)
. = ( 0xed41c - code32flat_start ) ;
*32flat.*(.rodata.__func__.5989)
. = ( 0xed42c - code32flat_start ) ;
*32flat.*(.rodata.__func__.5899)
. = ( 0xed43c - code32flat_start ) ;
*32flat.*(.rodata.speed_to_ctlsize)
. = ( 0xed44c - code32flat_start ) ;
*32flat.*(.rodata.__func__.5855)
. = ( 0xed460 - code32flat_start ) ;
*32flat.*(.rodata.__func__.5340)
. = ( 0xed474 - code32flat_start ) ;
*32flat.*(.rodata.__func__.5227)
. = ( 0xed480 - code32flat_start ) ;
*32flat.*(.rodata.__func__.5208)
. = ( 0xed490 - code32flat_start ) ;
*32flat.*(.rodata.__func__.5269)
. = ( 0xed4a0 - code32flat_start ) ;
*32flat.*(.rodata.mem_power.4691)
. = ( 0xed4a8 - code32flat_start ) ;
*32flat.*(.rodata.__func__.3459)
. = ( 0xed4b8 - code32flat_start ) ;
*32flat.*(.rodata.__func__.3206)
. = ( 0xed4c4 - code32flat_start ) ;
*32flat.*(.rodata.__func__.3156)
. = ( 0xed4d8 - code32flat_start ) ;
*32flat.*(.rodata.__func__.2711)
. = ( 0xed4e4 - code32flat_start ) ;
*32flat.*(.rodata.CSWTCH.1647)
. = ( 0xed4f8 - code32flat_start ) ;
*32flat.*(.data.pcimem_start)
. = ( 0xed500 - code32flat_start ) ;
*32flat.*(.data.pcimem64_start)
. = ( 0xed508 - code32flat_start ) ;
*32flat.*(.data.pcimem64_end)
. = ( 0xed510 - code32flat_start ) ;
*32flat.*(.data.pci_io_low_end)
. = ( 0xed518 - code32flat_start ) ;
*32flat.*(.data.varinit../src/malloc.c.36)
. = ( 0xed520 - code32flat_start ) ;
*32flat.*(.data.varinit../src/malloc.c.37)
. = ( 0xed524 - code32flat_start ) ;
*32flat.*(.data.varinit../src/malloc.c.38)
. = ( 0xed52c - code32flat_start ) ;
*32flat.*(.data.varinit../src/hw/pcidevice.c.16)
. = ( 0xed530 - code32flat_start ) ;
*32flat.*(.data.PIR_TABLE)
. = ( 0xed5b0 - code32flat_start ) ;
*32flat.*(.data.ssdp_proc_aml)
. = ( 0xed628 - code32flat_start ) ;
*32flat.*(.data.ssdp_pcihp_aml)
. = ( 0xed680 - code32flat_start ) ;
*32flat.*(.data.pci_slot_get_irq)
. = ( 0xed684 - code32flat_start ) ;
*32flat.*(.data.HubOp)
. = ( 0xed690 - code32flat_start ) ;
*32flat.*(.data.xhci_hub_ops)
. = ( 0xed69c - code32flat_start ) ;
*32flat.*(.data.zig2)
. = ( 0xed6dc - code32flat_start ) ;
*32flat.*(.data.varinit../src/boot.c.302)
. = ( 0xed6e0 - code32flat_start ) ;
*32flat.*(.data.varinit../src/boot.c.30)
. = ( 0xed6e4 - code32flat_start ) ;
*32flat.*(.data.DefaultCDPrio)
. = ( 0xed6e8 - code32flat_start ) ;
*32flat.*(.data.DefaultHDPrio)
. = ( 0xed6ec - code32flat_start ) ;
*32flat.*(.data.DefaultFloppyPrio)
. = ( 0xed6f0 - code32flat_start ) ;
*32flat.*(.data.DefaultBEVPrio)
. = ( 0xed6f4 - code32flat_start ) ;
*32flat.*(.data.varinit../src/romfile.c.13)
. = ( 0xed6f8 - code32flat_start ) ;
*32flat.*(.data.RomEnd)
. = ( 0xed6fc - code32flat_start ) ;
*32flat.*(.data.varinit../src/malloc.c.40)
. = ( 0xed710 - code32flat_start ) ;
*32flat.*(.data.MptIOCInitRequest)
. = ( 0xed728 - code32flat_start ) ;
*32flat.*(.data.ehci_HubOp)
. = ( 0xed734 - code32flat_start ) ;
*32flat.*(.data.ohci_HubOp)
. = ( 0xed740 - code32flat_start ) ;
*32flat.*(.data.uhci_HubOp)
. = ( 0xed74c - code32flat_start ) ;
*32flat.*(.bss.xen_hypercall_page)
. = ( 0xed750 - code32flat_start ) ;
*32flat.*(.bss.RamSize)
. = ( 0xed758 - code32flat_start ) ;
*32flat.*(.bss.RamSizeOver4G)
. = ( 0xed760 - code32flat_start ) ;
*32flat.*(.bss.SMBiosAddr)
. = ( 0xed764 - code32flat_start ) ;
*32flat.*(.bss.CDCount)
. = ( 0xed768 - code32flat_start ) ;
*32flat.*(.bss.usb_time_sigatt)
. = ( 0xed770 - code32flat_start ) ;
*32flat.*(.bss.used_bitmap.14418)
. = ( 0xed790 - code32flat_start ) ;
*32flat.*(.bss.TPM_has_physical_presence)
. = ( 0xed794 - code32flat_start ) ;
*32flat.*(.bss.BootsplashActive)
. = ( 0xed798 - code32flat_start ) ;
*32flat.*(.bss.BootorderCount)
. = ( 0xed79c - code32flat_start ) ;
*32flat.*(.bss.HaveHDBoot)
. = ( 0xed7a0 - code32flat_start ) ;
*32flat.*(.bss.HaveFDBoot)
. = ( 0xed7a4 - code32flat_start ) ;
*32flat.*(.bss.RunPCIroms)
. = ( 0xed7a8 - code32flat_start ) ;
*32flat.*(.bss.SpinupEnd)
. = ( 0xed7ac - code32flat_start ) ;
*32flat.*(.bss.ataid.7479)
. = ( 0xed7b0 - code32flat_start ) ;
*32flat.*(.bss.PendingEHCI)
. = ( 0xed7c0 - code32flat_start ) ;
*32flat.*(.text.set_equipment_flags)
. = ( 0xed7d1 - code32flat_start ) ;
*32flat.*(.text.runningOnXen)
. = ( 0xed7de - code32flat_start ) ;
*32flat.*(.text.threads_during_optionroms)
. = ( 0xed7f6 - code32flat_start ) ;
*32flat.*(.text.switch_next)
. = ( 0xed813 - code32flat_start ) ;
*32flat.*(.text.debug_putc)
. = ( 0xed81e - code32flat_start ) ;
*32flat.*(.text.puts)
. = ( 0xed840 - code32flat_start ) ;
*32flat.*(.text.putuint)
. = ( 0xed876 - code32flat_start ) ;
*32flat.*(.text.putsinglehex)
. = ( 0xed88d - code32flat_start ) ;
*32flat.*(.text.puthex)
. = ( 0xed910 - code32flat_start ) ;
*32flat.*(.text.putprettyhex)
. = ( 0xed958 - code32flat_start ) ;
*32flat.*(.text.bvprintf)
. = ( 0xedbab - code32flat_start ) ;
*32flat.*(.text.checksum)
. = ( 0xedbbe - code32flat_start ) ;
*32flat.*(.text.strlen)
. = ( 0xedbcd - code32flat_start ) ;
*32flat.*(.text.strcmp)
. = ( 0xedbed - code32flat_start ) ;
*32flat.*(.text.irqtimer_calc)
. = ( 0xedc55 - code32flat_start ) ;
*32flat.*(.text.irqtimer_check)
. = ( 0xedc78 - code32flat_start ) ;
*32flat.*(.text.pci_config_writel)
. = ( 0xedc9b - code32flat_start ) ;
*32flat.*(.text.pci_config_writew)
. = ( 0xedcc8 - code32flat_start ) ;
*32flat.*(.text.pci_config_writeb)
. = ( 0xedcf4 - code32flat_start ) ;
*32flat.*(.text.pci_config_readl)
. = ( 0xedd11 - code32flat_start ) ;
*32flat.*(.text.pci_config_readw)
. = ( 0xedd3a - code32flat_start ) ;
*32flat.*(.text.pci_config_readb)
. = ( 0xedd62 - code32flat_start ) ;
*32flat.*(.text.pci_next)
. = ( 0xeddae - code32flat_start ) ;
*32flat.*(.text.timer_adjust_bits)
. = ( 0xeddd1 - code32flat_start ) ;
*32flat.*(.text.timer_read)
. = ( 0xede22 - code32flat_start ) ;
*32flat.*(.text.timer_check)
. = ( 0xede36 - code32flat_start ) ;
*32flat.*(.text.timer_delay)
. = ( 0xede52 - code32flat_start ) ;
*32flat.*(.text.udelay)
. = ( 0xede6c - code32flat_start ) ;
*32flat.*(.text.timer_calc)
. = ( 0xede7f - code32flat_start ) ;
*32flat.*(.text.timer_calc_usec)
. = ( 0xedea4 - code32flat_start ) ;
*32flat.*(.text.pic_setup)
. = ( 0xedec9 - code32flat_start ) ;
*32flat.*(.text.__swab64)
. = ( 0xededa - code32flat_start ) ;
*32flat.*(.text.scsi_is_read)
. = ( 0xedefb - code32flat_start ) ;
*32flat.*(.text.code_mutable_preinit)
. = ( 0xedf17 - code32flat_start ) ;
*32flat.*(.text.rom_get_max)
. = ( 0xedf28 - code32flat_start ) ;
*32flat.*(.text.cpuid)
. = ( 0xedf81 - code32flat_start ) ;
*32flat.*(.text.find_fadt)
. = ( 0xedfda - code32flat_start ) ;
*32flat.*(.text.make_bios_readonly_intel)
. = ( 0xee076 - code32flat_start ) ;
*32flat.*(.text.mch_isa_lpc_setup)
. = ( 0xee0b3 - code32flat_start ) ;
*32flat.*(.text.piix4_pm_config_setup)
. = ( 0xee11a - code32flat_start ) ;
*32flat.*(.text.ich9_smbus_enable)
. = ( 0xee149 - code32flat_start ) ;
*32flat.*(.text.mch_mmconfig_setup)
. = ( 0xee178 - code32flat_start ) ;
*32flat.*(.text.smp_write_msrs)
. = ( 0xee1a3 - code32flat_start ) ;
*32flat.*(.text.apic_id_init)
. = ( 0xee216 - code32flat_start ) ;
*32flat.*(.text._vp_read)
. = ( 0xee3c1 - code32flat_start ) ;
*32flat.*(.text._vp_write)
. = ( 0xee4f1 - code32flat_start ) ;
*32flat.*(.text.vp_get_isr)
. = ( 0xee51a - code32flat_start ) ;
*32flat.*(.text.vp_notify)
. = ( 0xee5e6 - code32flat_start ) ;
*32flat.*(.text.tis_probe)
. = ( 0xee628 - code32flat_start ) ;
*32flat.*(.text.tis_init)
. = ( 0xee681 - code32flat_start ) ;
*32flat.*(.text.set_timeouts)
. = ( 0xee6ce - code32flat_start ) ;
*32flat.*(.text.smm_save_and_copy)
. = ( 0xee722 - code32flat_start ) ;
*32flat.*(.text.smm_relocate_and_restore)
. = ( 0xee786 - code32flat_start ) ;
*32flat.*(.text.smm_setup)
. = ( 0xee88d - code32flat_start ) ;
*32flat.*(.text.__make_bios_writable_intel)
. = ( 0xee914 - code32flat_start ) ;
*32flat.*(.text.make_bios_writable_intel)
. = ( 0xee93c - code32flat_start ) ;
*32flat.*(.text.xhci_xfer_queue)
. = ( 0xee9ed - code32flat_start ) ;
*32flat.*(.text.xhci_xfer_normal)
. = ( 0xeea17 - code32flat_start ) ;
*32flat.*(.text.tpm_log_event)
. = ( 0xeea83 - code32flat_start ) ;
*32flat.*(.text.be32_to_cpu)
. = ( 0xeea86 - code32flat_start ) ;
*32flat.*(.text.tpmhw_transmit)
. = ( 0xeeb04 - code32flat_start ) ;
*32flat.*(.text.sha1_block)
. = ( 0xeec75 - code32flat_start ) ;
*32flat.*(.text.cpu_to_be32)
. = ( 0xeec78 - code32flat_start ) ;
*32flat.*(.text.sha1_do)
. = ( 0xeed6b - code32flat_start ) ;
*32flat.*(.text.sha1)
. = ( 0xeeda0 - code32flat_start ) ;
*32flat.*(.text.tpm_build_digest)
. = ( 0xeeeca - code32flat_start ) ;
*32flat.*(.text.tpm_extend)
. = ( 0xef055 - code32flat_start ) ;
*32flat.*(.text.scsi_fill_cmd)
. = ( 0xef0be - code32flat_start ) ;
*32flat.*(.text.printf)
. = ( 0xef0d1 - code32flat_start ) ;
*32flat.*(.text.__dprintf)
. = ( 0xef0e4 - code32flat_start ) ;
*32flat.*(.text.make_bios_readonly)
. = ( 0xef12e - code32flat_start ) ;
*32flat.*(.text.make_bios_writable)
. = ( 0xef1ab - code32flat_start ) ;
*32flat.*(.text.xhci_print_port_state)
. = ( 0xef206 - code32flat_start ) ;
*32flat.*(.text.xhci_process_events)
. = ( 0xef319 - code32flat_start ) ;
*32flat.*(.text.is_valid_rom)
. = ( 0xef369 - code32flat_start ) ;
*32flat.*(.text.sdcard_reset)
. = ( 0xef3b1 - code32flat_start ) ;
*32flat.*(.text.i8042_wait_write)
. = ( 0xef3e7 - code32flat_start ) ;
*32flat.*(.text.tpm_build_and_send_cmd)
. = ( 0xef4b8 - code32flat_start ) ;
*32flat.*(.text.debug_banner)
. = ( 0xef4da - code32flat_start ) ;
*32flat.*(.text.panic)
. = ( 0xef4f0 - code32flat_start ) ;
*32flat.*(.text.call16)
. = ( 0xef587 - code32flat_start ) ;
*32flat.*(.text.yield)
. = ( 0xef5c1 - code32flat_start ) ;
*32flat.*(.text.tis_wait_sts)
. = ( 0xef62b - code32flat_start ) ;
*32flat.*(.text.tis_activate)
. = ( 0xef698 - code32flat_start ) ;
*32flat.*(.text.tis_find_active_locality)
. = ( 0xef6be - code32flat_start ) ;
*32flat.*(.text.tis_readresp)
. = ( 0xef700 - code32flat_start ) ;
*32flat.*(.text.tis_waitrespready)
. = ( 0xef737 - code32flat_start ) ;
*32flat.*(.text.tis_waitdatavalid)
. = ( 0xef761 - code32flat_start ) ;
*32flat.*(.text.tis_ready)
. = ( 0xef78c - code32flat_start ) ;
*32flat.*(.text.tis_senddata)
. = ( 0xef830 - code32flat_start ) ;
*32flat.*(.text.qemu_cfg_dma_transfer)
. = ( 0xef884 - code32flat_start ) ;
*32flat.*(.text.qemu_cfg_skip)
. = ( 0xef8b1 - code32flat_start ) ;
*32flat.*(.text.qemu_cfg_read)
. = ( 0xef8d7 - code32flat_start ) ;
*32flat.*(.text.qemu_cfg_read_entry)
. = ( 0xef90d - code32flat_start ) ;
*32flat.*(.text.qemu_get_present_cpus_count)
. = ( 0xef949 - code32flat_start ) ;
*32flat.*(.text.qemu_cfg_write_file_simple)
. = ( 0xef9bd - code32flat_start ) ;
*32flat.*(.text.smp_scan)
. = ( 0xefad8 - code32flat_start ) ;
*32flat.*(.text.sdcard_waitw)
. = ( 0xefb3f - code32flat_start ) ;
*32flat.*(.text.sdcard_pio)
. = ( 0xefbba - code32flat_start ) ;
*32flat.*(.text.sdcard_pio_transfer)
. = ( 0xefcd9 - code32flat_start ) ;
*32flat.*(.text.sdcard_readwrite)
. = ( 0xefd2b - code32flat_start ) ;
*32flat.*(.text.xhci_event_wait)
. = ( 0xefd8b - code32flat_start ) ;
*32flat.*(.text.ahci_command)
. = ( 0xeff40 - code32flat_start ) ;
*32flat.*(.text.ahci_disk_readwrite_aligned)
. = ( 0xf004d - code32flat_start ) ;
*32flat.*(.text.ahci_disk_readwrite)
. = ( 0xf010e - code32flat_start ) ;
*32flat.*(.text.megasas_fire_cmd)
. = ( 0xf01b5 - code32flat_start ) ;
*32flat.*(.text.uhci_waittick)
. = ( 0xf0204 - code32flat_start ) ;
*32flat.*(.text.timer_sleep)
. = ( 0xf0223 - code32flat_start ) ;
*32flat.*(.text.usleep)
. = ( 0xf023d - code32flat_start ) ;
*32flat.*(.text.yield_toirq)
. = ( 0xf0265 - code32flat_start ) ;
*32flat.*(.text._farcall16)
. = ( 0xf026f - code32flat_start ) ;
*32flat.*(.text.__call16_int)
. = ( 0xf028a - code32flat_start ) ;
*32flat.*(.text.screenc)
. = ( 0xf02c8 - code32flat_start ) ;
*32flat.*(.text.screen_putc)
. = ( 0xf02f6 - code32flat_start ) ;
*32flat.*(.text.call16_override)
. = ( 0xf032e - code32flat_start ) ;
*32flat.*(.text.farcall16big)
. = ( 0xf0345 - code32flat_start ) ;
*32flat.*(.text.call_boot_entry)
. = ( 0xf03a8 - code32flat_start ) ;
*32flat.*(.text.reset)
. = ( 0xf03bb - code32flat_start ) ;
*32flat.*(.text.boot_fail)
. = ( 0xf0420 - code32flat_start ) ;
*32flat.*(.text.hash_log_extend.clone.49)
. = ( 0xf04bc - code32flat_start ) ;
*32flat.*(.text.ehci_waittick.clone.57)
. = ( 0xf053d - code32flat_start ) ;
*32flat.*(.text.ehci_send_pipe)
. = ( 0xf07cc - code32flat_start ) ;
*32flat.*(.text.ohci_waittick.clone.58)
. = ( 0xf081a - code32flat_start ) ;
*32flat.*(.text.ohci_send_pipe)
. = ( 0xf0a17 - code32flat_start ) ;
*32flat.*(.text.wait_td.clone.59)
. = ( 0xf0a74 - code32flat_start ) ;
*32flat.*(.text.uhci_send_pipe)
. = ( 0xf0d0a - code32flat_start ) ;
*32flat.*(.text.usb_send_pipe)
. = ( 0xf0e6a - code32flat_start ) ;
*32flat.*(.text.uas_process_op)
. = ( 0xf0ff3 - code32flat_start ) ;
*32flat.*(.text.usb_process_op)
. = ( 0xf1114 - code32flat_start ) ;
*32flat.*(.text.vring_add_buf.clone.63)
. = ( 0xf1227 - code32flat_start ) ;
*32flat.*(.text.virtio_blk_op)
. = ( 0xf134f - code32flat_start ) ;
*32flat.*(.text.ndelay.clone.67)
. = ( 0xf136c - code32flat_start ) ;
*32flat.*(.text.rtc_mask.clone.68)
. = ( 0xf137d - code32flat_start ) ;
*32flat.*(.text.finish_preempt)
. = ( 0xf13b1 - code32flat_start ) ;
*32flat.*(.text.start_preempt)
. = ( 0xf13eb - code32flat_start ) ;
*32flat.*(.text.__callrom)
. = ( 0xf146e - code32flat_start ) ;
*32flat.*(.text.await_ide.clone.73)
. = ( 0xf14c9 - code32flat_start ) ;
*32flat.*(.text.await_not_bsy)
. = ( 0xf14d7 - code32flat_start ) ;
*32flat.*(.text.ndelay_await_not_bsy)
. = ( 0xf14e8 - code32flat_start ) ;
*32flat.*(.text.ata_wait_data)
. = ( 0xf1507 - code32flat_start ) ;
*32flat.*(.text.send_cmd)
. = ( 0xf15c2 - code32flat_start ) ;
*32flat.*(.text.ata_pio_transfer.clone.74)
. = ( 0xf166e - code32flat_start ) ;
*32flat.*(.text.tpm20_hierarchycontrol.clone.79)
. = ( 0xf1738 - code32flat_start ) ;
*32flat.*(.text.tpm_set_failure)
. = ( 0xf1779 - code32flat_start ) ;
*32flat.*(.text.tpm_add_measurement_to_log)
. = ( 0xf180b - code32flat_start ) ;
*32flat.*(.text.tpm_add_action)
. = ( 0xf182f - code32flat_start ) ;
*32flat.*(.text.boot_disk)
. = ( 0xf192d - code32flat_start ) ;
*32flat.*(.text.runtime../src/stacks.c.749)
. = ( 0xf193d - code32flat_start ) ;
*32flat.*(.text.runtime../src/block.c.553)
. = ( 0xf2480 - code32flat_start ) ;
*32flat.*(.text.process_op)
. = ( 0xf24c2 - code32flat_start ) ;
*32flat.*(.text.scsi_is_ready)
. = ( 0xf25ca - code32flat_start ) ;
*32flat.*(.text.cdrom_boot)
. = ( 0xf28f1 - code32flat_start ) ;
*32flat.*(.text.do_boot)
. = ( 0xf2a67 - code32flat_start ) ;
*32flat.*(.text.runtime../src/resume.c.146)
. = ( 0xf2d78 - code32flat_start ) ;
*32flat.*(.text.runtime../src/post.c.182)
. = ( 0xf2db7 - code32flat_start ) ;
*32flat.*(.text.runtime../src/post.c.318)
. = ( 0xf2e95 - code32flat_start ) ;
*32flat.*(.text.runtime../src/boot.c.760)
. = ( 0xf2ec1 - code32flat_start ) ;
*32flat.*(.text.runtime../src/boot.c.770)
. = ( 0xf2eee - code32flat_start ) ;
*32flat.*(.text.runtime../src/tcgbios.c.1465)
. = ( 0xf325a - code32flat_start ) ;
*32flat.*(.text.runtime../src/hw/usb-xhci.c.1129)
. = ( 0xf32d8 - code32flat_start ) ;
*32flat.*(.text.runtime../src/fw/smm.c.61)
. = ( 0xf34ce - code32flat_start ) ;
*32flat.*(.text.runtime../src/fw/smp.c.83)
. = ( 0xf34ec - code32flat_start ) ;
_rodata32flat = . ;
*32flat.*(.rodata)
. = ( 0xf5e10 - code32flat_start ) ;
*32flat.*(.rodata.puthex)
. = ( 0xf5e2c - code32flat_start ) ;
*32flat.*(.rodata.runtime../src/tcgbios.c.1465)
. = ( 0xf5e4c - code32flat_start ) ;
*32flat.*(.rodata.__func__.15176)
. = ( 0xf5e5c - code32flat_start ) ;
*32flat.*(.rodata.__func__.15212)
. = ( 0xf5e6c - code32flat_start ) ;
*32flat.*(.rodata.tpm_default_durations)
. = ( 0xf5e78 - code32flat_start ) ;
*32flat.*(.rodata.tis_default_timeouts)
. = ( 0xf5e88 - code32flat_start ) ;
*32flat.*(.rodata.__func__.14846)
. = ( 0xf5e98 - code32flat_start ) ;
*32flat.*(.rodata.__func__.13943)
. = ( 0xf5ea4 - code32flat_start ) ;
*32flat.*(.rodata.__func__.13259)
. = ( 0xf5ebc - code32flat_start ) ;
*32flat.*(.rodata.__func__.13240)
. = ( 0xf5ecc - code32flat_start ) ;
*32flat.*(.rodata.__func__.12072)
. = ( 0xf5edc - code32flat_start ) ;
*32flat.*(.rodata.__func__.12065)
. = ( 0xf5eec - code32flat_start ) ;
*32flat.*(.rodata.__func__.11754)
. = ( 0xf5f00 - code32flat_start ) ;
*32flat.*(.rodata.speed_name)
. = ( 0xf5f40 - code32flat_start ) ;
*32flat.*(.rodata.__func__.11935)
. = ( 0xf5f50 - code32flat_start ) ;
*32flat.*(.rodata.__func__.11776)
. = ( 0xf5f60 - code32flat_start ) ;
*32flat.*(.rodata.__func__.11207)
. = ( 0xf5f70 - code32flat_start ) ;
*32flat.*(.rodata.C.609.23352)
. = ( 0xf5f84 - code32flat_start ) ;
*32flat.*(.rodata.sha_ko.11011)
. = ( 0xf5f94 - code32flat_start ) ;
*32flat.*(.rodata.__func__.10563)
. = ( 0xf5fab - code32flat_start ) ;
*32flat.*(.rodata.Startup_ST_STATE)
. = ( 0xf5fad - code32flat_start ) ;
*32flat.*(.rodata.Startup_SU_STATE)
. = ( 0xf5faf - code32flat_start ) ;
*32flat.*(.rodata.TPM2_SelfTest_YES)
. = ( 0xf5fb0 - code32flat_start ) ;
*32flat.*(.rodata.__func__.9213)
. = ( 0xf5fbc - code32flat_start ) ;
*32flat.*(.rodata.__func__.9208)
. = ( 0xf5fc8 - code32flat_start ) ;
*32flat.*(.rodata.__func__.7769)
. = ( 0xf5fdc - code32flat_start ) ;
*32flat.*(.rodata.__func__.7202)
. = ( 0xf5fe8 - code32flat_start ) ;
*32flat.*(.rodata.__func__.6554)
. = ( 0xf5ff8 - code32flat_start ) ;
*32flat.*(.rodata.__func__.6522)
. = ( 0xf6008 - code32flat_start ) ;
*32flat.*(.rodata.__func__.6391)
. = ( 0xf6018 - code32flat_start ) ;
*32flat.*(.rodata.__func__.6307)
. = ( 0xf6028 - code32flat_start ) ;
*32flat.*(.rodata.__func__.6287)
. = ( 0xf6030 - code32flat_start ) ;
*32flat.*(.rodata.__func__.6169)
. = ( 0xf6040 - code32flat_start ) ;
*32flat.*(.rodata.__func__.6072)
. = ( 0xf6048 - code32flat_start ) ;
*32flat.*(.rodata.__func__.6062)
. = ( 0xf6054 - code32flat_start ) ;
*32flat.*(.rodata.__func__.5958)
. = ( 0xf6064 - code32flat_start ) ;
*32flat.*(.rodata.__func__.5217)
. = ( 0xf6078 - code32flat_start ) ;
*32flat.*(.rodata.CSWTCH.1521)
. = ( 0xf60bc - code32flat_start ) ;
*32flat.*(.rodata.CSWTCH.1660)
. = ( 0xf60f8 - code32flat_start ) ;
*32flat.*(.data.acpi_pm_base)
. = ( 0xf60fc - code32flat_start ) ;
*32flat.*(.data.tpm_drivers)
. = ( 0xf612c - code32flat_start ) ;
*32flat.*(.data.TPMHW_driver_to_use)
. = ( 0xf6130 - code32flat_start ) ;
*32flat.*(.data.SMMISADeviceBDF)
. = ( 0xf6134 - code32flat_start ) ;
*32flat.*(.data.SMMPMDeviceBDF)
. = ( 0xf6138 - code32flat_start ) ;
*32flat.*(.data.MCHMmcfgBDF)
. = ( 0xf613c - code32flat_start ) ;
*32flat.*(.data.ICH9SmbusBDF)
. = ( 0xf6140 - code32flat_start ) ;
*32flat.*(.data.PiixPmBDF)
. = ( 0xf6144 - code32flat_start ) ;
*32flat.*(.data.ICH9LpcBDF)
. = ( 0xf6148 - code32flat_start ) ;
*32flat.*(.data.ShadowBDF)
. = ( 0xf614c - code32flat_start ) ;
*32flat.*(.data.CheckFloppySig)
. = ( 0xf6150 - code32flat_start ) ;
*32flat.*(.data.debuginfo)
. = ( 0xf6154 - code32flat_start ) ;
*32flat.*(.data.screeninfo)
. = ( 0xf6158 - code32flat_start ) ;
*32flat.*(.data.VERSION)
. = ( 0xf6180 - code32flat_start ) ;
*32flat.*(.data.BUILDINFO)
. = ( 0xf61dc - code32flat_start ) ;
*32flat.*(.bss.cfg_dma_enabled)
. = ( 0xf61e0 - code32flat_start ) ;
*32flat.*(.bss.xen_cpuid_base)
. = ( 0xf61e4 - code32flat_start ) ;
*32flat.*(.bss.RsdpAddr)
. = ( 0xf61e8 - code32flat_start ) ;
*32flat.*(.bss.MaxCountCPUs)
. = ( 0xf61ec - code32flat_start ) ;
*32flat.*(.bss.ScreenAndDebug)
. = ( 0xf61f0 - code32flat_start ) ;
*32flat.*(.bss.VgaROM)
. = ( 0xf61f4 - code32flat_start ) ;
*32flat.*(.bss.SMPLock)
. = ( 0xf61f8 - code32flat_start ) ;
*32flat.*(.bss.SMPStack)
. = ( 0xf61fc - code32flat_start ) ;
*32flat.*(.bss.tpm_default_dur)
. = ( 0xf6208 - code32flat_start ) ;
*32flat.*(.bss.tpm_default_to)
. = ( 0xf6218 - code32flat_start ) ;
*32flat.*(.bss.romfile_pointer_list)
. = ( 0xf621c - code32flat_start ) ;
*32flat.*(.bss.smp_msr)
. = ( 0xf639c - code32flat_start ) ;
*32flat.*(.bss.smp_msr_count)
. = ( 0xf63a0 - code32flat_start ) ;
*32flat.*(.bss.CountCPUs)
. = ( 0xf63a4 - code32flat_start ) ;
*32flat.*(.bss.FoundAPICIDs)
. = ( 0xf63c4 - code32flat_start ) ;
*32flat.*(.bss.acpi_reset_reg)
. = ( 0xf63d0 - code32flat_start ) ;
*32flat.*(.bss.acpi_reset_val)
. = ( 0xf63d1 - code32flat_start ) ;
*32flat.*(.bss.TPM_version)
. = ( 0xf63d4 - code32flat_start ) ;
*32flat.*(.bss.tpm20_pcr_selection)
. = ( 0xf63d8 - code32flat_start ) ;
*32flat.*(.bss.tpm20_pcr_selection_size)
. = ( 0xf63dc - code32flat_start ) ;
*32flat.*(.bss.BEVCount)
. = ( 0xf63e0 - code32flat_start ) ;
*32flat.*(.bss.BEV)
. = ( 0xf6480 - code32flat_start ) ;
*32flat.*(.bss.BootRetryTime)
. = ( 0xf6484 - code32flat_start ) ;
*32flat.*(.bss.S3ResumeVga)
. = ( 0xf6488 - code32flat_start ) ;
*32flat.*(.bss.EnforceChecksum)
. = ( 0xf648c - code32flat_start ) ;
*32flat.*(.bss.RomBase)
. = ( 0xf6490 - code32flat_start ) ;
*32flat.*(.bss.PreemptCount)
. = ( 0xf6494 - code32flat_start ) ;
*32flat.*(.bss.CanInterrupt)
. = ( 0xf6495 - code32flat_start ) ;
*32flat.*(.bss.ThreadControl)
. = ( 0xf6ca0 - code32flat_start ) ;
*32flat.*(.data.varfseg../src/misc.c.140)
. = ( 0xf6ca8 - code32flat_start ) ;
*32flat.*(.data.varfseg../src/misc.c.150)
. = ( 0xf6cb0 - code32flat_start ) ;
*32flat.*(.data.varfseg../src/misc.c.156)
. = ( 0xf6ce8 - code32flat_start ) ;
*32flat.*(.data.varfseg../src/misc.c.174)
. = ( 0xf6cf0 - code32flat_start ) ;
*32flat.*(.data.varfseg../src/stacks.c.469)
. = ( 0xf6d00 - code32flat_start ) ;
*32flat.*(.data.varfseg../src/pnpbios.c.18)
. = ( 0xf6d30 - code32flat_start ) ;
*32flat.*(.data.varfseg../src/pcibios.c.229)
. = ( 0xf6d40 - code32flat_start ) ;
*32flat.*(.data.varfseg../src/hw/timer.c.52)
. = ( 0xf6d44 - code32flat_start ) ;
*32flat.*(.data.varfseg../src/hw/timer.c.53)
. = ( 0xf6d46 - code32flat_start ) ;
*32flat.*(.data.varfseg../src/hw/serialio.c.80)
. = ( 0xf6d48 - code32flat_start ) ;
*32flat.*(.data.varfseg../src/hw/floppy.c.42)
. = ( 0xf6d58 - code32flat_start ) ;
*32flat.*(.data.varfseg../src/hw/floppy.c.75)
. = ( 0xf6dc0 - code32flat_start ) ;
*32flat.*(.data.varfseg../src/pmm.c.19)
. = ( 0xf6dd0 - code32flat_start ) ;
*32flat.*(.data.varfseg../src/stacks.c.38)
. = ( 0xf6dd4 - code32flat_start ) ;
*32flat.*(.data.varfseg../src/misc.c.18)
. = ( 0xf6dd8 - code32flat_start ) ;
*32flat.*(.data.varfseg../src/misc.c.147)
. = ( 0xf6ddc - code32flat_start ) ;
*32flat.*(.data.varfseg../src/fw/paravirt.c.34)
. = ( 0xf6de0 - code32flat_start ) ;
*32flat.*(.data.varfseg../src/malloc.c.468)
. = ( 0xf6de4 - code32flat_start ) ;
*32flat.*(.data.varfseg../src/cdrom.c.27)
. = ( 0xf6de8 - code32flat_start ) ;
*32flat.*(.data.varfseg../src/fw/biostables.c.22)
. = ( 0xf6dec - code32flat_start ) ;
*32flat.*(.data.varfseg../src/fw/biostables.c.177)
. = ( 0xf6df0 - code32flat_start ) ;
*32flat.*(.data.varfseg../src/stacks.c.683)
. = ( 0xf6df4 - code32flat_start ) ;
*32flat.*(.data.varfseg../src/hw/pcidevice.c.17)
. = ( 0xf6df8 - code32flat_start ) ;
*32flat.*(.data.varfseg../src/block.c.30)
. = ( 0xf6dfc - code32flat_start ) ;
*32flat.*(.data.varfseg../src/block.c.33)
. = ( 0xf6e00 - code32flat_start ) ;
*32flat.*(.data.varfseg../src/block.c.32)
. = ( 0xf6ec0 - code32flat_start ) ;
*32flat.*(.data.varfseg../src/e820map.c.18)
. = ( 0xf7140 - code32flat_start ) ;
*32flat.*(.data.varfseg../src/e820map.c.19)
. = ( 0xf7144 - code32flat_start ) ;
*32flat.*(.data.varfseg../src/vgahooks.c.22)
. = ( 0xf7148 - code32flat_start ) ;
*32flat.*(.data.varfseg../src/vgahooks.c.40)
. = ( 0xf7150 - code32flat_start ) ;
*32flat.*(.data.varfseg../src/vgahooks.c.179)
. = ( 0xf7152 - code32flat_start ) ;
*32flat.*(.data.varfseg../src/vgahooks.c.262)
. = ( 0xf7153 - code32flat_start ) ;
*32flat.*(.data.varfseg../src/hw/timer.c.54)
. = ( 0xf7154 - code32flat_start ) ;
*32flat.*(.data.varfseg../src/hw/usb-hid.c.15)
. = ( 0xf7158 - code32flat_start ) ;
*32flat.*(.data.varfseg../src/hw/usb-hid.c.16)
. = ( 0xf7160 - code32flat_start ) ;
*32flat.*(.text.32fseg../src/stacks.c.208)
. = ( 0xf7186 - code32flat_start ) ;
*32flat.*(.text.32fseg../src/stacks.c.293)
. = ( 0xf71af - code32flat_start ) ;
*32seg.*(.text.get_global_offset)
. = ( 0xf71bb - code32flat_start ) ;
*32seg.*(.text.pci_next)
. = ( 0xf7228 - code32flat_start ) ;
*32seg.*(.text.putc.clone.18)
. = ( 0xf723d - code32flat_start ) ;
*32seg.*(.text.putsinglehex.clone.20)
. = ( 0xf7252 - code32flat_start ) ;
*32seg.*(.text.puthex.clone.21)
. = ( 0xf72d7 - code32flat_start ) ;
*32seg.*(.text.putprettyhex.clone.22)
. = ( 0xf730c - code32flat_start ) ;
*32seg.*(.text.puts.clone.23)
. = ( 0xf7322 - code32flat_start ) ;
*32seg.*(.text.putuint.clone.24)
. = ( 0xf7350 - code32flat_start ) ;
*32seg.*(.text.__dprintf)
. = ( 0xf754a - code32flat_start ) ;
*32seg.*(.text.handle_pcibios)
. = ( 0xf7874 - code32flat_start ) ;
*32seg.*(.text.handle_apm)
. = ( 0xf79ee - code32flat_start ) ;
_rodata32seg = . ;
*32seg.*(.rodata)
. = ( 0xf7a18 - code32flat_start ) ;
*16.*(.text.set_a20)
. = ( 0xf7a42 - code32flat_start ) ;
*16.*(.text.pic_eoi2)
. = ( 0xf7a4a - code32flat_start ) ;
*16.*(.text.call32_prep)
. = ( 0xf7ae0 - code32flat_start ) ;
*16.*(.text.call32_post)
. = ( 0xf7b7b - code32flat_start ) ;
*16.*(.text.on_extra_stack)
. = ( 0xf7b9f - code32flat_start ) ;
*16.*(.text.need_hop_back)
. = ( 0xf7bb1 - code32flat_start ) ;
*16.*(.text.__stack_hop_back)
. = ( 0xf7c24 - code32flat_start ) ;
*16.*(.text.memcpy_fl)
. = ( 0xf7c5f - code32flat_start ) ;
*16.*(.text.getDrive)
. = ( 0xf7c84 - code32flat_start ) ;
*16.*(.text.fill_generic_edd)
. = ( 0xf7fcd - code32flat_start ) ;
*16.*(.text.edd_pci_path)
. = ( 0xf7ffd - code32flat_start ) ;
*16.*(.text.getLCHS)
. = ( 0xf807a - code32flat_start ) ;
*16.*(.text.enqueue_key)
. = ( 0xf80d2 - code32flat_start ) ;
*16.*(.text.kbd_set_flag)
. = ( 0xf812b - code32flat_start ) ;
*16.*(.text.getComAddr)
. = ( 0xf815d - code32flat_start ) ;
*16.*(.text.irqtimer_calc_ticks)
. = ( 0xf8182 - code32flat_start ) ;
*16.*(.text.pci_next)
. = ( 0xf820f - code32flat_start ) ;
*16.*(.text.timer_adjust_bits)
. = ( 0xf824c - code32flat_start ) ;
*16.*(.text.timer_read)
. = ( 0xf82a1 - code32flat_start ) ;
*16.*(.text.timer_check)
. = ( 0xf82bd - code32flat_start ) ;
*16.*(.text.udelay)
. = ( 0xf82de - code32flat_start ) ;
*16.*(.text.timer_calc)
. = ( 0xf82fc - code32flat_start ) ;
*16.*(.text.ehci_reset_pipe)
. = ( 0xf833f - code32flat_start ) ;
*16.*(.text.floppy_dor_write)
. = ( 0xf8354 - code32flat_start ) ;
*16.*(.text.floppy_disable_controller)
. = ( 0xf835a - code32flat_start ) ;
*16.*(.text.lba2chs)
. = ( 0xf83a5 - code32flat_start ) ;
*16.*(.text.scsi_fill_cmd)
. = ( 0xf8416 - code32flat_start ) ;
*16.*(.text.default_process_op.clone.9)
. = ( 0xf8439 - code32flat_start ) ;
*16.*(.text.__disk_ret.clone.10)
. = ( 0xf8477 - code32flat_start ) ;
*16.*(.text.disk_1315)
. = ( 0xf84d9 - code32flat_start ) ;
*16.*(.text.__disk_stub.clone.12)
. = ( 0xf84e0 - code32flat_start ) ;
*16.*(.text.disk_13XX.clone.33)
. = ( 0xf8513 - code32flat_start ) ;
*16.*(.text.puts_cs.clone.57)
. = ( 0xf852a - code32flat_start ) ;
*16.*(.text.putsinglehex.clone.58)
. = ( 0xf8542 - code32flat_start ) ;
*16.*(.text.puthex.clone.59)
. = ( 0xf85eb - code32flat_start ) ;
*16.*(.text.putprettyhex.clone.60)
. = ( 0xf862d - code32flat_start ) ;
*16.*(.text.puts.clone.61)
. = ( 0xf8643 - code32flat_start ) ;
*16.*(.text.putuint.clone.62)
. = ( 0xf8682 - code32flat_start ) ;
*16.*(.text.bvprintf.clone.63)
. = ( 0xf88aa - code32flat_start ) ;
*16.*(.text.__dprintf)
. = ( 0xf88be - code32flat_start ) ;
*16.*(.text.i8042_command)
. = ( 0xf8990 - code32flat_start ) ;
*16.*(.text.panic)
. = ( 0xf89a6 - code32flat_start ) ;
*16.*(.text.clear_usertimer)
. = ( 0xf89e7 - code32flat_start ) ;
*16.*(.text.set_usertimer)
. = ( 0xf8a65 - code32flat_start ) ;
*16.*(.text.rtc_setup)
. = ( 0xf8a8d - code32flat_start ) ;
*16.*(.text.handle_12)
. = ( 0xf8aa0 - code32flat_start ) ;
*16.*(.text.handle_11)
. = ( 0xf8ab3 - code32flat_start ) ;
*16.*(.text.handle_05)
. = ( 0xf8b60 - code32flat_start ) ;
*16.*(.text.handle_02)
. = ( 0xf8b76 - code32flat_start ) ;
*16.*(.text.call16_helper)
. = ( 0xf8bbe - code32flat_start ) ;
*16.*(.text.__call32)
. = ( 0xf8c82 - code32flat_start ) ;
*16.*(.text.__call32_params.clone.91)
. = ( 0xf8cca - code32flat_start ) ;
*16.*(.text.usb_poll_intr)
. = ( 0xf8fc7 - code32flat_start ) ;
*16.*(.text._farcall16)
. = ( 0xf9008 - code32flat_start ) ;
*16.*(.text.__call16_int)
. = ( 0xf9019 - code32flat_start ) ;
*16.*(.text.ramdisk_copy)
. = ( 0xf919b - code32flat_start ) ;
*16.*(.text.process_key)
. = ( 0xf9587 - code32flat_start ) ;
*16.*(.text.prockeys)
. = ( 0xf95fd - code32flat_start ) ;
*16.*(.text.procmodkey)
. = ( 0xf965d - code32flat_start ) ;
*16.*(.text.procscankey)
. = ( 0xf9683 - code32flat_start ) ;
*16.*(.text.disk_1346.clone.78)
. = ( 0xf971f - code32flat_start ) ;
*16.*(.text.handle_75)
. = ( 0xf9778 - code32flat_start ) ;
*16.*(.text.check_irqs)
. = ( 0xf979a - code32flat_start ) ;
*16.*(.text.floppy_wait_irq)
. = ( 0xf9817 - code32flat_start ) ;
*16.*(.text.floppy_pio)
. = ( 0xf9954 - code32flat_start ) ;
*16.*(.text.floppy_enable_controller)
. = ( 0xf999b - code32flat_start ) ;
*16.*(.text.floppy_drive_pio)
. = ( 0xf9a29 - code32flat_start ) ;
*16.*(.text.floppy_dma_cmd)
. = ( 0xf9b7c - code32flat_start ) ;
*16.*(.text.floppy_drive_readid.clone.95)
. = ( 0xf9bc9 - code32flat_start ) ;
*16.*(.text.wait_td.clone.81)
. = ( 0xf9c42 - code32flat_start ) ;
*16.*(.text.ps2_recvbyte)
. = ( 0xf9d01 - code32flat_start ) ;
*16.*(.text.ps2_sendbyte)
. = ( 0xf9d79 - code32flat_start ) ;
*16.*(.text.mouse_command)
. = ( 0xf9e4b - code32flat_start ) ;
*16.*(.text.handle_15c2)
. = ( 0xfa079 - code32flat_start ) ;
*16.*(.text.kbd_command)
. = ( 0xfa0ab - code32flat_start ) ;
*16.*(.text.handle_160a.clone.82)
. = ( 0xfa0f2 - code32flat_start ) ;
*16.*(.text.msleep)
. = ( 0xfa101 - code32flat_start ) ;
*16.*(.text.usleep)
. = ( 0xfa122 - code32flat_start ) ;
*16.*(.text.await_ide.clone.89)
. = ( 0xfa19b - code32flat_start ) ;
*16.*(.text.await_not_bsy)
. = ( 0xfa1aa - code32flat_start ) ;
*16.*(.text.ndelay_await_not_bsy)
. = ( 0xfa1dc - code32flat_start ) ;
*16.*(.text.ata_wait_data)
. = ( 0xfa204 - code32flat_start ) ;
*16.*(.text.send_cmd)
. = ( 0xfa314 - code32flat_start ) ;
*16.*(.text.ata_pio_transfer)
. = ( 0xfa468 - code32flat_start ) ;
*16.*(.text.ata_readwrite)
. = ( 0xfa618 - code32flat_start ) ;
*16.*(.text.uhci_send_pipe.clone.93)
. = ( 0xfa961 - code32flat_start ) ;
*16.*(.text.usb_msc_send)
. = ( 0xfa98d - code32flat_start ) ;
*16.*(.text.process_op_16)
. = ( 0xfbd0e - code32flat_start ) ;
*16.*(.text.process_op)
. = ( 0xfbd6b - code32flat_start ) ;
*16.*(.text.disk_1305)
. = ( 0xfbf05 - code32flat_start ) ;
*16.*(.text.extended_access)
. = ( 0xfbfc9 - code32flat_start ) ;
*16.*(.text.disk_13)
. = ( 0xfc377 - code32flat_start ) ;
*16.*(.text.wait_irq)
. = ( 0xfc397 - code32flat_start ) ;
*16.*(.text.handle_1553)
. = ( 0xfc4fd - code32flat_start ) ;
*16.*(.text.handle_40)
. = ( 0xfc5b4 - code32flat_start ) ;
*16.*(.text.handle_13)
. = ( 0xfc662 - code32flat_start ) ;
*16.*(.text.handle_76)
. = ( 0xfc673 - code32flat_start ) ;
*16.*(.text.invoke_mouse_handler)
. = ( 0xfc6e8 - code32flat_start ) ;
*16.*(.text.process_mouse)
. = ( 0xfc743 - code32flat_start ) ;
*16.*(.text.handle_16)
. = ( 0xfc845 - code32flat_start ) ;
*16.*(.text.handle_1589)
. = ( 0xfc8e3 - code32flat_start ) ;
*16.*(.text.handle_17)
. = ( 0xfca1c - code32flat_start ) ;
*16.*(.text.handle_1a)
. = ( 0xfcc96 - code32flat_start ) ;
*16.*(.text.handle_70)
. = ( 0xfcd91 - code32flat_start ) ;
*16.*(.text.handle_resume)
. = ( 0xfce56 - code32flat_start ) ;
*16.*(.text.handle_pnp)
. = ( 0xfce9e - code32flat_start ) ;
*16.*(.text.handle_pcibios)
. = ( 0xfd1f8 - code32flat_start ) ;
*16.*(.text.handle_74)
. = ( 0xfd235 - code32flat_start ) ;
*16.*(.text.handle_09)
. = ( 0xfd27e - code32flat_start ) ;
*16.*(.text.handle_0e)
. = ( 0xfd298 - code32flat_start ) ;
*16.*(.text.asm.transition32)
. = ( 0xfd2e6 - code32flat_start ) ;
*16.*(.text.asm.transition16)
. = ( 0xfd334 - code32flat_start ) ;
*16.*(.text.asm.__farcall16)
. = ( 0xfd3c1 - code32flat_start ) ;
*16.*(.text.asm.irq_trampoline_0x02)
. = ( 0xfd3c4 - code32flat_start ) ;
*16.*(.text.asm.irq_trampoline_0x05)
. = ( 0xfd3c7 - code32flat_start ) ;
*16.*(.text.asm.irq_trampoline_0x10)
. = ( 0xfd3ca - code32flat_start ) ;
*16.*(.text.asm.irq_trampoline_0x13)
. = ( 0xfd3cd - code32flat_start ) ;
*16.*(.text.asm.irq_trampoline_0x15)
. = ( 0xfd3d0 - code32flat_start ) ;
*16.*(.text.asm.irq_trampoline_0x16)
. = ( 0xfd3d3 - code32flat_start ) ;
*16.*(.text.asm.irq_trampoline_0x18)
. = ( 0xfd3d6 - code32flat_start ) ;
*16.*(.text.asm.entry_smi)
. = ( 0xfd3eb - code32flat_start ) ;
*16.*(.text.asm.entry_smp)
. = ( 0xfd41b - code32flat_start ) ;
*16.*(.text.asm.entry_resume)
. = ( 0xfd430 - code32flat_start ) ;
*16.*(.text.asm.entry_pmm)
. = ( 0xfd48e - code32flat_start ) ;
*16.*(.text.asm.entry_pnp_real)
. = ( 0xfd4d6 - code32flat_start ) ;
*16.*(.text.asm.entry_apm16)
. = ( 0xfd517 - code32flat_start ) ;
*16.*(.text.asm.entry_apm32)
. = ( 0xfd549 - code32flat_start ) ;
*16.*(.text.asm.entry_pcibios32)
. = ( 0xfd577 - code32flat_start ) ;
*16.*(.text.asm.entry_pcibios16)
. = ( 0xfd5b1 - code32flat_start ) ;
*16.*(.text.asm.entry_1589)
. = ( 0xfd5eb - code32flat_start ) ;
*16.*(.text.asm.irqentry_extrastack)
. = ( 0xfd678 - code32flat_start ) ;
*16.*(.text.asm.irqentry_arg_extrastack)
. = ( 0xfd71a - code32flat_start ) ;
*16.*(.text.asm.entry_13)
. = ( 0xfd723 - code32flat_start ) ;
*16.*(.text.asm.entry_70)
. = ( 0xfd72c - code32flat_start ) ;
*16.*(.text.asm.entry_74)
. = ( 0xfd735 - code32flat_start ) ;
*16.*(.text.asm.entry_75)
. = ( 0xfd73e - code32flat_start ) ;
*16.*(.text.asm.entry_19)
. = ( 0xfd751 - code32flat_start ) ;
*16.*(.text.asm.entry_18)
. = ( 0xfd764 - code32flat_start ) ;
_rodata16 = . ;
*16.*(.rodata)
. = ( 0xfdba8 - code32flat_start ) ;
*16.*(.rodata.__func__.11362)
. = ( 0xfdbbc - code32flat_start ) ;
*16.*(.rodata.__func__.10554)
. = ( 0xfdbc8 - code32flat_start ) ;
*16.*(.rodata.__func__.10596)
. = ( 0xfdbd4 - code32flat_start ) ;
*16.*(.rodata.__func__.10202)
. = ( 0xfdbe4 - code32flat_start ) ;
*16.*(.rodata.__func__.10222)
. = ( 0xfdbf0 - code32flat_start ) ;
*16.*(.rodata.__func__.9305)
. = ( 0xfdc00 - code32flat_start ) ;
*16.*(.rodata.__func__.9227)
. = ( 0xfdc10 - code32flat_start ) ;
*16.*(.rodata.__func__.7807)
. = ( 0xfdc18 - code32flat_start ) ;
*16.*(.rodata.__func__.7714)
. = ( 0xfdc24 - code32flat_start ) ;
*16.*(.rodata.__func__.7587)
. = ( 0xfdc34 - code32flat_start ) ;
*16.*(.rodata.__func__.6666)
. = ( 0xfdc48 - code32flat_start ) ;
*16.*(.rodata.__func__.6657)
. = ( 0xfdc58 - code32flat_start ) ;
*16.*(.rodata.__func__.6718)
. = ( 0xfdc68 - code32flat_start ) ;
*16.*(.rodata.__func__.4247)
. = ( 0xfdc74 - code32flat_start ) ;
*16.*(.rodata.__func__.4599)
. = ( 0xfdc80 - code32flat_start ) ;
*16.*(.rodata.__func__.1677)
. = ( 0xfdc8c - code32flat_start ) ;
*16.*(.rodata.__func__.1664)
. = ( 0xfdc98 - code32flat_start ) ;
*16.*(.rodata.__func__.1656)
. = ( 0xfdca4 - code32flat_start ) ;
*16.*(.data16../src/kbd.c.371)
. = ( 0xfdcac - code32flat_start ) ;
*16.*(.data16../src/kbd.c.374)
. = ( 0xfdcb4 - code32flat_start ) ;
*16.*(.data16../src/hw/usb-hid.c.159)
. = ( 0xfdcc4 - code32flat_start ) ;
*16.*(.data16../src/hw/usb-hid.c.142)
. = ( 0xfdd8c - code32flat_start ) ;
*16.*(.data16../src/kbd.c.279)
. = ( 0xfe054 - code32flat_start ) ;
*16.*(.data16../src/mouse.c.106)
. = ( 0xfe05b - code32flat_start ) ;
*16.*(.fixedaddr.0xe05b)
. = ( 0xfe079 - code32flat_start ) ;
*16.*(.text.__ps2_command)
. = ( 0xfe2b8 - code32flat_start ) ;
*16.*(.text.asm.entry_76)
. = ( 0xfe2c3 - code32flat_start ) ;
*16.*(.fixedaddr.0xe2c3)
. = ( 0xfe2e8 - code32flat_start ) ;
*16.*(.text.basic_access)
. = ( 0xfe3f9 - code32flat_start ) ;
*16.*(.text.asm.irq_trampoline_0x1b)
. = ( 0xfe3fe - code32flat_start ) ;
*16.*(.fixedaddr.0xe3fe)
. = ( 0xfe401 - code32flat_start ) ;
*32flat.*(.fixedaddr.0xe401)
. = ( 0xfe411 - code32flat_start ) ;
*16.*(.text.handle_08)
. = ( 0xfe6f2 - code32flat_start ) ;
*16.*(.fixedaddr.0xe6f2)
. = ( 0xfe6f5 - code32flat_start ) ;
*32flat.*(.fixedaddr.0xe6f5)
. = ( 0xfe6ff - code32flat_start ) ;
*16.*(.text.timer_sleep)
. = ( 0xfe729 - code32flat_start ) ;
*32flat.*(.fixedaddr.0xe729)
. = ( 0xfe739 - code32flat_start ) ;
*16.*(.fixedaddr.0xe739)
. = ( 0xfe742 - code32flat_start ) ;
*16.*(.text.dequeue_key)
. = ( 0xfe82e - code32flat_start ) ;
*16.*(.fixedaddr.0xe82e)
. = ( 0xfe837 - code32flat_start ) ;
*16.*(.text.disk_1308)
. = ( 0xfe97c - code32flat_start ) ;
*16.*(.text.asm.entry_hwpic2)
. = ( 0xfe987 - code32flat_start ) ;
*16.*(.fixedaddr.0xe987)
. = ( 0xfe990 - code32flat_start ) ;
*16.*(.text.floppy_prep)
. = ( 0xfec20 - code32flat_start ) ;
*16.*(.text.irqtimer_check)
. = ( 0xfec59 - code32flat_start ) ;
*16.*(.fixedaddr.0xec59)
. = ( 0xfec62 - code32flat_start ) ;
*16.*(.text.ehci_send_pipe.clone.94)
. = ( 0xfef42 - code32flat_start ) ;
*16.*(.text.rtc_mask.clone.92)
. = ( 0xfef57 - code32flat_start ) ;
*16.*(.fixedaddr.0xef57)
. = ( 0xfef60 - code32flat_start ) ;
*16.*(.text.set_leds)
. = ( 0xfefc7 - code32flat_start ) ;
*32flat.*(.fixedaddr.0xefc7)
. = ( 0xfefd2 - code32flat_start ) ;
*16.*(.fixedaddr.0xefd2)
. = ( 0xfefdb - code32flat_start ) ;
*16.*(.text.uhci_waittick)
. = ( 0xff03f - code32flat_start ) ;
*16.*(.text.handle_hwpic1)
. = ( 0xff045 - code32flat_start ) ;
*16.*(.fixedaddr.0xf045)
. = ( 0xff046 - code32flat_start ) ;
*16.*(.text.asm.entry_bios32)
. = ( 0xff065 - code32flat_start ) ;
*16.*(.fixedaddr.0xf065)
. = ( 0xff06e - code32flat_start ) ;
*16.*(.text.getLptAddr)
. = ( 0xff0a1 - code32flat_start ) ;
*16.*(.text.asm.irq_trampoline_0x4a)
. = ( 0xff0a4 - code32flat_start ) ;
*32flat.*(.fixedaddr.0xf0a4)
. = ( 0xff0fc - code32flat_start ) ;
*16.*(.text.handle_15)
. = ( 0xff627 - code32flat_start ) ;
*16.*(.text.handle_14)
. = ( 0xff7f0 - code32flat_start ) ;
*16.*(.text.usb_send_bulk)
. = ( 0xff83e - code32flat_start ) ;
*16.*(.text.asm.irq_trampoline_0x19)
. = ( 0xff841 - code32flat_start ) ;
*16.*(.fixedaddr.0xf841)
. = ( 0xff84a - code32flat_start ) ;
*16.*(.text.handle_hwpic2)
. = ( 0xff84d - code32flat_start ) ;
*16.*(.fixedaddr.0xf84d)
. = ( 0xff856 - code32flat_start ) ;
*16.*(.text.handle_apm)
. = ( 0xff859 - code32flat_start ) ;
*16.*(.fixedaddr.0xf859)
. = ( 0xff869 - code32flat_start ) ;
*16.*(.text.fill_edd)
. = ( 0xffa65 - code32flat_start ) ;
*16.*(.text.asm.entry_hwpic1)
. = ( 0xffa6e - code32flat_start ) ;
*32flat.*(.fixedaddr.0xfa6e)
. = ( 0xffe6e - code32flat_start ) ;
*16.*(.fixedaddr.0xfe6e)
. = ( 0xffe7e - code32flat_start ) ;
*16.*(.text.timer_delay)
. = ( 0xffea5 - code32flat_start ) ;
*16.*(.fixedaddr.0xfea5)
. = ( 0xffeae - code32flat_start ) ;
*16.*(.text.i8042_wait_write)
. = ( 0xffef3 - code32flat_start ) ;
*32flat.*(.fixedaddr.0xfef3)
. = ( 0xfff00 - code32flat_start ) ;
*16.*(.text.rtc_updating)
. = ( 0xfff4f - code32flat_start ) ;
*16.*(.text.asm.irq_trampoline_0x1c)
. = ( 0xfff53 - code32flat_start ) ;
*16.*(.fixedaddr.0xff53)
. = ( 0xfff54 - code32flat_start ) ;
*16.*(.fixedaddr.0xff54)
. = ( 0xfff5d - code32flat_start ) ;
*16.*(.text.handle_legacy_disk)
. = ( 0xfffee - code32flat_start ) ;
*16.*(.text.handle_10)
. = ( 0xffff0 - code32flat_start ) ;
*16.*(.fixedaddr.0xfff0)
. = ( 0xffff5 - code32flat_start ) ;
*32flat.*(.fixedaddr.0xfff5)
. = ( 0xffffe - code32flat_start ) ;
*32flat.*(.fixedaddr.0xfffe)
. = ( 0xfffff - code32flat_start ) ;
*32flat.*(.fixedaddr.0xffff)

        code32flat_end = ABSOLUTE(.) ;
    } :text


        /* Discard regular data sections to force a link error if
         * code attempts to access data not marked with VAR16 (or other
         * appropriate macro)
         */
        /DISCARD/ : {
                *(.text*) *(.data*) *(.bss*) *(.rodata*)
                *(COMMON) *(.discard*) *(.eh_frame) *(.note*)
                }
}

ENTRY(reset_vector)
PHDRS
{
        text PT_LOAD AT ( code32flat_start ) ;
}
