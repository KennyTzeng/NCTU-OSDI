
/* DO NOT EDIT!  This is an autogenerated file.  See scripts/layoutrom.py. */
OUTPUT_FORMAT("elf32-i386")
OUTPUT_ARCH("i386")
SECTIONS
{
_cfunc32flat_tpm_interrupt_handler32 = 0xf2eee ;
e820_list = 0x6ec0 ;
_cfunc32flat_handle_smi = 0xf32d8 ;
_cfunc16_check_irqs = 0x9778 ;
MaxPCIBus = 0x6df4 ;
_cfunc32flat_call32_params_helper = 0xf192d ;
DebugOutputPort = 0x6d46 ;
IntelDisplayType = 0x7150 ;
reply_msg = 0xfb14 ;
HaveSmmCall32 = 0x6dd0 ;
e820_count = 0x7140 ;
TimerKHz = 0x6d40 ;
LegacyRamSize = 0x6de0 ;
CDRom_locks = 0xfaec ;
acpi_pm1a_cnt = 0x6dec ;
FloppyInfo = 0x6d58 ;
ViaRamSpeed = 0x714c ;
SMPLock = 0xf61f4 ;
_cfunc32flat_handle_resume32 = 0xf2a67 ;
emulated_drive_gf = 0xfae8 ;
_cfunc32flat_xhci_poll_intr = 0xf325a ;
_cfunc32flat_process_op_32 = 0xf193d ;
_cfunc16_invoke_mouse_handler = 0xc673 ;
mouse_pipe = 0x7158 ;
bounce_buf_fl = 0x6dfc ;
StackPos = 0xfabc ;
_cfunc32flat_handle_smp = 0xf34ce ;
DefaultDPTE = 0xfad8 ;
CanPreempt = 0x6df0 ;
VGAHookHandlerType = 0x7144 ;
_cfunc32seg_handle_pcibios = 0x754a ;
SMPStack = 0xf61f8 ;
IntelDisplayId = 0x7151 ;
FloppyCount = 0x6df8 ;
ShiftTSC = 0x7153 ;
_cfunc32flat_handle_pmm = 0xeb637 ;
_cfunc16_wait_irq = 0xc377 ;
IDMap = 0x6e00 ;
Call16Data = 0xfac0 ;
MainThread = 0x6cf0 ;
pmode_IDT_info = 0x6ca8 ;
PirAddr = 0x6de8 ;
_cfunc32flat_handle_19 = 0xf2ec1 ;
SmiBootDisplay = 0x7152 ;
CDEmu = 0xf2a0 ;
ViaFBsize = 0x7148 ;
LastUSBkey = 0xfb08 ;
keyboard_pipe = 0x7154 ;
_cfunc32seg_handle_apm = 0x7874 ;
HaveRunPost = 0x6dd4 ;
rombios32_gdt_48 = 0x6ce8 ;
_cfunc32flat_yield_preempt = 0xe803d ;
Century = 0xfafc ;
ExtraStack = 0xf2b8 ;
diskette_param_table2 = 0x6d48 ;
rmode_IDT_info = 0x6ca0 ;
_cfunc32flat_handle_18 = 0xf2e95 ;
TimerPort = 0x6d44 ;
_cfunc16__farcall16 = 0x8fc7 ;
Ps2ctr = 0xf2b3 ;
FloppyDOR = 0xfb10 ;
BIOS_CONFIG_TABLE = 0xe6f5 ;
RTCusers = 0xfb04 ;
cdemu_drive_gf = 0x6de4 ;
TimerLast = 0xfb00 ;
_cfunc32flat_handle_post = 0xf2db7 ;

    zonelow_base = 0xca000 ;
    _zonelow_seg = 0xca00 ;

.text.set_a20 0x7a18 : { *(.text.set_a20) }
.text.pic_eoi2 0x7a42 : { *(.text.pic_eoi2) }
.text.call32_prep 0x7a4a : { *(.text.call32_prep) }
.text.call32_post 0x7ae0 : { *(.text.call32_post) }
.text.on_extra_stack 0x7b7b : { *(.text.on_extra_stack) }
.text.need_hop_back 0x7b9f : { *(.text.need_hop_back) }
.text.__stack_hop_back 0x7bb1 : { *(.text.__stack_hop_back) }
.text.memcpy_fl 0x7c24 : { *(.text.memcpy_fl) }
.text.getDrive 0x7c5f : { *(.text.getDrive) }
.text.fill_generic_edd 0x7c84 : { *(.text.fill_generic_edd) }
.text.edd_pci_path 0x7fcd : { *(.text.edd_pci_path) }
.text.fill_edd 0xf869 : { *(.text.fill_edd) }
.text.getLCHS 0x7ffd : { *(.text.getLCHS) }
.text.enqueue_key 0x807a : { *(.text.enqueue_key) }
.text.kbd_set_flag 0x80d2 : { *(.text.kbd_set_flag) }
.text.getComAddr 0x812b : { *(.text.getComAddr) }
.text.getLptAddr 0xf06e : { *(.text.getLptAddr) }
.text.irqtimer_calc_ticks 0x815d : { *(.text.irqtimer_calc_ticks) }
.text.irqtimer_check 0xec20 : { *(.text.irqtimer_check) }
.text.pci_next 0x8182 : { *(.text.pci_next) }
.text.timer_adjust_bits 0x820f : { *(.text.timer_adjust_bits) }
.text.timer_read 0x824c : { *(.text.timer_read) }
.text.timer_check 0x82a1 : { *(.text.timer_check) }
.text.timer_delay 0xfe7e : { *(.text.timer_delay) }
.text.udelay 0x82bd : { *(.text.udelay) }
.text.timer_calc 0x82de : { *(.text.timer_calc) }
.text.ehci_reset_pipe 0x82fc : { *(.text.ehci_reset_pipe) }
.text.floppy_dor_write 0x833f : { *(.text.floppy_dor_write) }
.text.floppy_disable_controller 0x8354 : { *(.text.floppy_disable_controller) }
.text.lba2chs 0x835a : { *(.text.lba2chs) }
.text.scsi_fill_cmd 0x83a5 : { *(.text.scsi_fill_cmd) }
.text.default_process_op.clone.9 0x8416 : { *(.text.default_process_op.clone.9) }
.text.__disk_ret.clone.10 0x8439 : { *(.text.__disk_ret.clone.10) }
.text.disk_1308 0xe837 : { *(.text.disk_1308) }
.text.disk_1315 0x8477 : { *(.text.disk_1315) }
.text.__disk_stub.clone.12 0x84d9 : { *(.text.__disk_stub.clone.12) }
.text.disk_13XX.clone.33 0x84e0 : { *(.text.disk_13XX.clone.33) }
.text.puts_cs.clone.57 0x8513 : { *(.text.puts_cs.clone.57) }
.text.putsinglehex.clone.58 0x852a : { *(.text.putsinglehex.clone.58) }
.text.puthex.clone.59 0x8542 : { *(.text.puthex.clone.59) }
.text.putprettyhex.clone.60 0x85eb : { *(.text.putprettyhex.clone.60) }
.text.puts.clone.61 0x862d : { *(.text.puts.clone.61) }
.text.putuint.clone.62 0x8643 : { *(.text.putuint.clone.62) }
.text.bvprintf.clone.63 0x8682 : { *(.text.bvprintf.clone.63) }
.text.__dprintf 0x88aa : { *(.text.__dprintf) }
.text.i8042_wait_write 0xfeae : { *(.text.i8042_wait_write) }
.text.i8042_command 0x88be : { *(.text.i8042_command) }
.text.panic 0x8990 : { *(.text.panic) }
.text.rtc_mask.clone.92 0xef42 : { *(.text.rtc_mask.clone.92) }
.text.clear_usertimer 0x89a6 : { *(.text.clear_usertimer) }
.text.set_usertimer 0x89e7 : { *(.text.set_usertimer) }
.text.rtc_setup 0x8a65 : { *(.text.rtc_setup) }
.text.handle_12 0x8a8d : { *(.text.handle_12) }
.text.handle_11 0x8aa0 : { *(.text.handle_11) }
.text.handle_05 0x8ab3 : { *(.text.handle_05) }
.text.handle_10 0xffee : { *(.text.handle_10) }
.text.handle_02 0x8b60 : { *(.text.handle_02) }
.text.call16_helper 0x8b76 : { *(.text.call16_helper) }
.text.__call32 0x8bbe : { *(.text.__call32) }
.text.__call32_params.clone.91 0x8c82 : { *(.text.__call32_params.clone.91) }
.text.usb_poll_intr 0x8cca : { *(.text.usb_poll_intr) }
.text._farcall16 0x8fc7 : { *(.text._farcall16) }
.text.__call16_int 0x9008 : { *(.text.__call16_int) }
.text.ramdisk_copy 0x9019 : { *(.text.ramdisk_copy) }
.text.process_key 0x919b : { *(.text.process_key) }
.text.prockeys 0x9587 : { *(.text.prockeys) }
.text.procmodkey 0x95fd : { *(.text.procmodkey) }
.text.procscankey 0x965d : { *(.text.procscankey) }
.text.disk_1346.clone.78 0x9683 : { *(.text.disk_1346.clone.78) }
.text.handle_75 0x971f : { *(.text.handle_75) }
.text.check_irqs 0x9778 : { *(.text.check_irqs) }
.text.floppy_wait_irq 0x979a : { *(.text.floppy_wait_irq) }
.text.floppy_pio 0x9817 : { *(.text.floppy_pio) }
.text.floppy_enable_controller 0x9954 : { *(.text.floppy_enable_controller) }
.text.floppy_drive_pio 0x999b : { *(.text.floppy_drive_pio) }
.text.floppy_dma_cmd 0x9a29 : { *(.text.floppy_dma_cmd) }
.text.floppy_drive_readid.clone.95 0x9b7c : { *(.text.floppy_drive_readid.clone.95) }
.text.floppy_prep 0xe990 : { *(.text.floppy_prep) }
.text.wait_td.clone.81 0x9bc9 : { *(.text.wait_td.clone.81) }
.text.uhci_waittick 0xefdb : { *(.text.uhci_waittick) }
.text.ps2_recvbyte 0x9c42 : { *(.text.ps2_recvbyte) }
.text.ps2_sendbyte 0x9d01 : { *(.text.ps2_sendbyte) }
.text.__ps2_command 0xe079 : { *(.text.__ps2_command) }
.text.mouse_command 0x9d79 : { *(.text.mouse_command) }
.text.handle_15c2 0x9e4b : { *(.text.handle_15c2) }
.text.kbd_command 0xa079 : { *(.text.kbd_command) }
.text.set_leds 0xef60 : { *(.text.set_leds) }
.text.handle_160a.clone.82 0xa0ab : { *(.text.handle_160a.clone.82) }
.text.rtc_updating 0xff00 : { *(.text.rtc_updating) }
.text.timer_sleep 0xe6ff : { *(.text.timer_sleep) }
.text.msleep 0xa0f2 : { *(.text.msleep) }
.text.usleep 0xa101 : { *(.text.usleep) }
.text.await_ide.clone.89 0xa122 : { *(.text.await_ide.clone.89) }
.text.await_not_bsy 0xa19b : { *(.text.await_not_bsy) }
.text.ndelay_await_not_bsy 0xa1aa : { *(.text.ndelay_await_not_bsy) }
.text.ata_wait_data 0xa1dc : { *(.text.ata_wait_data) }
.text.send_cmd 0xa204 : { *(.text.send_cmd) }
.text.ata_pio_transfer 0xa314 : { *(.text.ata_pio_transfer) }
.text.ata_readwrite 0xa468 : { *(.text.ata_readwrite) }
.text.uhci_send_pipe.clone.93 0xa618 : { *(.text.uhci_send_pipe.clone.93) }
.text.ehci_send_pipe.clone.94 0xec62 : { *(.text.ehci_send_pipe.clone.94) }
.text.usb_send_bulk 0xf7f0 : { *(.text.usb_send_bulk) }
.text.usb_msc_send 0xa961 : { *(.text.usb_msc_send) }
.text.process_op_16 0xa98d : { *(.text.process_op_16) }
.text.process_op 0xbd0e : { *(.text.process_op) }
.text.basic_access 0xe2e8 : { *(.text.basic_access) }
.text.disk_1305 0xbd6b : { *(.text.disk_1305) }
.text.extended_access 0xbf05 : { *(.text.extended_access) }
.text.disk_13 0xbfc9 : { *(.text.disk_13) }
.text.handle_legacy_disk 0xff5d : { *(.text.handle_legacy_disk) }
.text.wait_irq 0xc377 : { *(.text.wait_irq) }
.text.handle_1553 0xc397 : { *(.text.handle_1553) }
.text.dequeue_key 0xe742 : { *(.text.dequeue_key) }
.text.handle_40 0xc4fd : { *(.text.handle_40) }
.text.handle_13 0xc5b4 : { *(.text.handle_13) }
.text.handle_76 0xc662 : { *(.text.handle_76) }
.text.invoke_mouse_handler 0xc673 : { *(.text.invoke_mouse_handler) }
.text.process_mouse 0xc6e8 : { *(.text.process_mouse) }
.text.handle_16 0xc743 : { *(.text.handle_16) }
.text.handle_1589 0xc845 : { *(.text.handle_1589) }
.text.handle_15 0xf0fc : { *(.text.handle_15) }
.text.handle_14 0xf627 : { *(.text.handle_14) }
.text.handle_17 0xc8e3 : { *(.text.handle_17) }
.text.handle_1a 0xca1c : { *(.text.handle_1a) }
.text.handle_08 0xe411 : { *(.text.handle_08) }
.text.handle_70 0xcc96 : { *(.text.handle_70) }
.text.handle_resume 0xcd91 : { *(.text.handle_resume) }
.text.handle_pnp 0xce56 : { *(.text.handle_pnp) }
.text.handle_pcibios 0xce9e : { *(.text.handle_pcibios) }
.text.handle_apm 0xf856 : { *(.text.handle_apm) }
.text.handle_hwpic1 0xf03f : { *(.text.handle_hwpic1) }
.text.handle_hwpic2 0xf84a : { *(.text.handle_hwpic2) }
.text.handle_74 0xd1f8 : { *(.text.handle_74) }
.text.handle_09 0xd235 : { *(.text.handle_09) }
.text.handle_0e 0xd27e : { *(.text.handle_0e) }
.text.asm.transition32 0xd298 : { *(.text.asm.transition32) }
.text.asm.transition16 0xd2e6 : { *(.text.asm.transition16) }
.text.asm.__farcall16 0xd334 : { *(.text.asm.__farcall16) }
.text.asm.irq_trampoline_0x02 0xd3c1 : { *(.text.asm.irq_trampoline_0x02) }
.text.asm.irq_trampoline_0x05 0xd3c4 : { *(.text.asm.irq_trampoline_0x05) }
.text.asm.irq_trampoline_0x10 0xd3c7 : { *(.text.asm.irq_trampoline_0x10) }
.text.asm.irq_trampoline_0x13 0xd3ca : { *(.text.asm.irq_trampoline_0x13) }
.text.asm.irq_trampoline_0x15 0xd3cd : { *(.text.asm.irq_trampoline_0x15) }
.text.asm.irq_trampoline_0x16 0xd3d0 : { *(.text.asm.irq_trampoline_0x16) }
.text.asm.irq_trampoline_0x18 0xd3d3 : { *(.text.asm.irq_trampoline_0x18) }
.text.asm.irq_trampoline_0x19 0xf83e : { *(.text.asm.irq_trampoline_0x19) }
.text.asm.irq_trampoline_0x1b 0xe3f9 : { *(.text.asm.irq_trampoline_0x1b) }
.text.asm.irq_trampoline_0x1c 0xff4f : { *(.text.asm.irq_trampoline_0x1c) }
.text.asm.irq_trampoline_0x4a 0xf0a1 : { *(.text.asm.irq_trampoline_0x4a) }
.text.asm.entry_smi 0xd3d6 : { *(.text.asm.entry_smi) }
.text.asm.entry_smp 0xd3eb : { *(.text.asm.entry_smp) }
.text.asm.entry_resume 0xd41b : { *(.text.asm.entry_resume) }
.text.asm.entry_pmm 0xd430 : { *(.text.asm.entry_pmm) }
.text.asm.entry_pnp_real 0xd48e : { *(.text.asm.entry_pnp_real) }
.text.asm.entry_apm16 0xd4d6 : { *(.text.asm.entry_apm16) }
.text.asm.entry_apm32 0xd517 : { *(.text.asm.entry_apm32) }
.text.asm.entry_pcibios32 0xd549 : { *(.text.asm.entry_pcibios32) }
.text.asm.entry_pcibios16 0xd577 : { *(.text.asm.entry_pcibios16) }
.text.asm.entry_1589 0xd5b1 : { *(.text.asm.entry_1589) }
.text.asm.entry_bios32 0xf046 : { *(.text.asm.entry_bios32) }
.text.asm.irqentry_extrastack 0xd5eb : { *(.text.asm.irqentry_extrastack) }
.text.asm.irqentry_arg_extrastack 0xd678 : { *(.text.asm.irqentry_arg_extrastack) }
.text.asm.entry_13 0xd71a : { *(.text.asm.entry_13) }
.text.asm.entry_76 0xe2b8 : { *(.text.asm.entry_76) }
.text.asm.entry_70 0xd723 : { *(.text.asm.entry_70) }
.text.asm.entry_74 0xd72c : { *(.text.asm.entry_74) }
.text.asm.entry_75 0xd735 : { *(.text.asm.entry_75) }
.text.asm.entry_hwpic1 0xfa65 : { *(.text.asm.entry_hwpic1) }
.text.asm.entry_hwpic2 0xe97c : { *(.text.asm.entry_hwpic2) }
.text.asm.entry_19 0xd73e : { *(.text.asm.entry_19) }
.text.asm.entry_18 0xd751 : { *(.text.asm.entry_18) }
.rodata 0xd764 : { *(.rodata) }
.rodata.__func__.11362 0xdba8 : { *(.rodata.__func__.11362) }
.rodata.__func__.10554 0xdbbc : { *(.rodata.__func__.10554) }
.rodata.__func__.10596 0xdbc8 : { *(.rodata.__func__.10596) }
.rodata.__func__.10202 0xdbd4 : { *(.rodata.__func__.10202) }
.rodata.__func__.10222 0xdbe4 : { *(.rodata.__func__.10222) }
.rodata.__func__.9305 0xdbf0 : { *(.rodata.__func__.9305) }
.rodata.__func__.9227 0xdc00 : { *(.rodata.__func__.9227) }
.rodata.__func__.7807 0xdc10 : { *(.rodata.__func__.7807) }
.rodata.__func__.7714 0xdc18 : { *(.rodata.__func__.7714) }
.rodata.__func__.7587 0xdc24 : { *(.rodata.__func__.7587) }
.rodata.__func__.6666 0xdc34 : { *(.rodata.__func__.6666) }
.rodata.__func__.6657 0xdc48 : { *(.rodata.__func__.6657) }
.rodata.__func__.6718 0xdc58 : { *(.rodata.__func__.6718) }
.rodata.__func__.4247 0xdc68 : { *(.rodata.__func__.4247) }
.rodata.__func__.4599 0xdc74 : { *(.rodata.__func__.4599) }
.rodata.__func__.1677 0xdc80 : { *(.rodata.__func__.1677) }
.rodata.__func__.1664 0xdc8c : { *(.rodata.__func__.1664) }
.rodata.__func__.1656 0xdc98 : { *(.rodata.__func__.1656) }
.data16../src/kbd.c.371 0xdca4 : { *(.data16../src/kbd.c.371) }
.data16../src/kbd.c.374 0xdcac : { *(.data16../src/kbd.c.374) }
.data16../src/hw/usb-hid.c.159 0xdcb4 : { *(.data16../src/hw/usb-hid.c.159) }
.data16../src/hw/usb-hid.c.142 0xdcc4 : { *(.data16../src/hw/usb-hid.c.142) }
.data16../src/kbd.c.279 0xdd8c : { *(.data16../src/kbd.c.279) }
.data16../src/mouse.c.106 0xe054 : { *(.data16../src/mouse.c.106) }
.fixedaddr.0xe05b 0xe05b : { *(.fixedaddr.0xe05b) }
.fixedaddr.0xe2c3 0xe2c3 : { *(.fixedaddr.0xe2c3) }
.fixedaddr.0xe3fe 0xe3fe : { *(.fixedaddr.0xe3fe) }
.fixedaddr.0xe6f2 0xe6f2 : { *(.fixedaddr.0xe6f2) }
.fixedaddr.0xe739 0xe739 : { *(.fixedaddr.0xe739) }
.fixedaddr.0xe82e 0xe82e : { *(.fixedaddr.0xe82e) }
.fixedaddr.0xe987 0xe987 : { *(.fixedaddr.0xe987) }
.fixedaddr.0xec59 0xec59 : { *(.fixedaddr.0xec59) }
.fixedaddr.0xef57 0xef57 : { *(.fixedaddr.0xef57) }
.fixedaddr.0xefd2 0xefd2 : { *(.fixedaddr.0xefd2) }
.fixedaddr.0xf045 0xf045 : { *(.fixedaddr.0xf045) }
.fixedaddr.0xf065 0xf065 : { *(.fixedaddr.0xf065) }
.fixedaddr.0xf841 0xf841 : { *(.fixedaddr.0xf841) }
.fixedaddr.0xf84d 0xf84d : { *(.fixedaddr.0xf84d) }
.fixedaddr.0xf859 0xf859 : { *(.fixedaddr.0xf859) }
.fixedaddr.0xfe6e 0xfe6e : { *(.fixedaddr.0xfe6e) }
.fixedaddr.0xfea5 0xfea5 : { *(.fixedaddr.0xfea5) }
.fixedaddr.0xff53 0xff53 : { *(.fixedaddr.0xff53) }
.fixedaddr.0xff54 0xff54 : { *(.fixedaddr.0xff54) }
.fixedaddr.0xfff0 0xfff0 : { *(.fixedaddr.0xfff0) }



        /* Discard regular data sections to force a link error if
         * code attempts to access data not marked with VAR16 (or other
         * appropriate macro)
         */
        /DISCARD/ : {
                *(.text*) *(.data*) *(.bss*) *(.rodata*)
                *(COMMON) *(.discard*) *(.eh_frame) *(.note*)
                }
}
